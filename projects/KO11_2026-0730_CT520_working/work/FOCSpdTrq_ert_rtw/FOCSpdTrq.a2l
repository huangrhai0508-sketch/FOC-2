/******************************************************************************
* ASAP2 file: FOCSpdTrq.a2l
* Code generation for model "FOCSpdTrq".
* Model version : 1.197
* Simulink Coder version : 10.6 R2022b
* C source code generated on : Tue Jul 28 23:07:47 2026
* Target selection: ert.tlc
* Embedded hardware selection: Infineon->TriCore
* Code generation objectives: Unspecified
* Validation result: Not run
* (add additional file header information here)
******************************************************************************/ ASAP2_VERSION 1 31
/* Version 1.31 */
/begin PROJECT ProjectName "Project Comment Goes Here"
/begin HEADER "Header Comments go here" /end HEADER
/begin MODULE ModuleName "Module Comment Goes Here"
/begin MOD_PAR "MOD PAR Comment Goes Here" /end MOD_PAR
/begin MOD_COMMON "Mod Common Comment Here" BYTE_ORDER MSB_LAST ALIGNMENT_BYTE 1 ALIGNMENT_WORD 2 ALIGNMENT_LONG 4 ALIGNMENT_FLOAT32_IEEE 4 ALIGNMENT_FLOAT64_IEEE 4 /end MOD_COMMON
/begin CHARACTERISTIC cphase_T_P1 "flux with Iq" /* Characteristic Type */ CURVE 0x0000 /* @ECU_Address@cphase_T_P1@ */ cphaseST_P1 /* Maxdiff */ 0 FOCSpdTrq_CM_single_NA -1.400000 0.000000
 /begin AXIS_DESCR /* Description of X-Axis Points */ /* Axis Type */ STD_AXIS /* Reference to Input */ GRSU.f32_SpeedAct_rpm FOCSpdTrq_CM_single_A /* Number of Axis Pts */ 33 -7000.000000 7000.000000 /end AXIS_DESCR
/end CHARACTERISTIC
/begin CHARACTERISTIC cripple_T_P1 "flux with Iq" /* Characteristic Type */ CURVE 0x0000 /* @ECU_Address@cripple_T_P1@ */ crippleST_P1 /* Maxdiff */ 0 FOCSpdTrq_CM_single_NA 0.000000 0.900000
 /begin AXIS_DESCR /* Description of X-Axis Points */ /* Axis Type */ STD_AXIS /* Reference to Input */ NO_INPUT_QUANTITY FOCSpdTrq_CM_single_A /* Number of Axis Pts */ 15 0.000000 7000.000000 /end AXIS_DESCR
/end CHARACTERISTIC
/begin CHARACTERISTIC f32_P_SpdNeglimit_rpm "Todo" VALUE 0x0000 /* @ECU_Address@f32_P_SpdNeglimit_rpm@ */ Record_FLOAT32_IEEE 0 FOCSpdTrq_CM_single_NA -10000.000000 0.000000 /end CHARACTERISTIC
/begin CHARACTERISTIC f32_P_SpdPoslimit_rpm "Todo" VALUE 0x0000 /* @ECU_Address@f32_P_SpdPoslimit_rpm@ */ Record_FLOAT32_IEEE 0 FOCSpdTrq_CM_single_NA 0.000000 10000.000000 /end CHARACTERISTIC
/begin CHARACTERISTIC f32_P_SpeedPiMaxRatio "Todo" VALUE 0x0000 /* @ECU_Address@f32_P_SpeedPiMaxRatio@ */ Record_FLOAT32_IEEE 0 FOCSpdTrq_CM_single_NA 0.000000 1.000000 /end CHARACTERISTIC
/begin CHARACTERISTIC f32_P_SpeedPiMinRatio "Todo" VALUE 0x0000 /* @ECU_Address@f32_P_SpeedPiMinRatio@ */ Record_FLOAT32_IEEE 0 FOCSpdTrq_CM_single_NA 0.000000 1.000000 /end CHARACTERISTIC
/begin CHARACTERISTIC g_msgCore0to2_AsrKpHi "Todo" VALUE 0x0000 /* @ECU_Address@g_msgCore0to2_AsrKpHi@ */ Record_FLOAT32_IEEE 0 FOCSpdTrq_CM_single_NA 0.000000 10.000000 /end CHARACTERISTIC
/begin CHARACTERISTIC g_msgCore0to2_AsrKpLo "Todo" VALUE 0x0000 /* @ECU_Address@g_msgCore0to2_AsrKpLo@ */ Record_FLOAT32_IEEE 0 FOCSpdTrq_CM_single_NA 0.000000 10.000000 /end CHARACTERISTIC
/begin CHARACTERISTIC g_msgCore0to2_AsrKpZero "Todo" VALUE 0x0000 /* @ECU_Address@g_msgCore0to2_AsrKpZero@ */ Record_FLOAT32_IEEE 0 FOCSpdTrq_CM_single_NA -10000.000000 10000.000000 /end CHARACTERISTIC
/begin CHARACTERISTIC g_msgCore0to2_AsrSwtHiRpm "Todo" VALUE 0x0000 /* @ECU_Address@g_msgCore0to2_AsrSwtHiRpm@ */ Record_FLOAT32_IEEE 0 FOCSpdTrq_CM_single_NA 0.000000 6000.000000 /end CHARACTERISTIC
/begin CHARACTERISTIC g_msgCore0to2_AsrSwtLoRpm "Todo" VALUE 0x0000 /* @ECU_Address@g_msgCore0to2_AsrSwtLoRpm@ */ Record_FLOAT32_IEEE 0 FOCSpdTrq_CM_single_NA 0.000000 6000.000000 /end CHARACTERISTIC
/begin CHARACTERISTIC g_msgCore0to2_AsrTiHi "Todo" VALUE 0x0000 /* @ECU_Address@g_msgCore0to2_AsrTiHi@ */ Record_FLOAT32_IEEE 0 FOCSpdTrq_CM_single_NA 0.000000 1.000000 /end CHARACTERISTIC
/begin CHARACTERISTIC g_msgCore0to2_AsrTiLo "Todo" VALUE 0x0000 /* @ECU_Address@g_msgCore0to2_AsrTiLo@ */ Record_FLOAT32_IEEE 0 FOCSpdTrq_CM_single_NA 0.000000 1.000000 /end CHARACTERISTIC
/begin CHARACTERISTIC g_msgCore0to2_AsrTiZero "Todo" VALUE 0x0000 /* @ECU_Address@g_msgCore0to2_AsrTiZero@ */ Record_FLOAT32_IEEE 0 FOCSpdTrq_CM_single_NA -10000.000000 10000.000000 /end CHARACTERISTIC
/begin CHARACTERISTIC g_msgCore0to2_Asrctrlmode "Todo" VALUE 0x0000 /* @ECU_Address@g_msgCore0to2_Asrctrlmode@ */ Record_FLOAT32_IEEE 0 FOCSpdTrq_CM_single_NA 0.000000 10.000000 /end CHARACTERISTIC
/begin CHARACTERISTIC g_msgCore0to2_CalibEn2 "Todo" VALUE 0x0000 /* @ECU_Address@g_msgCore0to2_CalibEn2@ */ Record_BOOLEAN 0 FOCSpdTrq_CM_logical_NA 0.000000 1.000000 /end CHARACTERISTIC
/begin CHARACTERISTIC g_msgCore0to2_HFcoef "Todo" VALUE 0x0000 /* @ECU_Address@g_msgCore0to2_HFcoef@ */ Record_FLOAT32_IEEE 0 FOCSpdTrq_CM_single_NA -10000.000000 10000.000000 /end CHARACTERISTIC
/begin CHARACTERISTIC g_msgCore0to2_H_coef "Todo" VALUE 0x0000 /* @ECU_Address@g_msgCore0to2_H_coef@ */ Record_FLOAT32_IEEE 0 FOCSpdTrq_CM_single_NA -10000.000000 10000.000000 /end CHARACTERISTIC
/begin CHARACTERISTIC g_msgCore0to2_K1 "Todo" VALUE 0x0000 /* @ECU_Address@g_msgCore0to2_K1@ */ Record_FLOAT32_IEEE 0 FOCSpdTrq_CM_single_NA -10000.000000 10000.000000 /end CHARACTERISTIC
/begin CHARACTERISTIC g_msgCore0to2_K1switch "Todo" VALUE 0x0000 /* @ECU_Address@g_msgCore0to2_K1switch@ */ Record_BOOLEAN 0 FOCSpdTrq_CM_logical_NA 0.000000 1.000000 /end CHARACTERISTIC
/begin CHARACTERISTIC g_msgCore0to2_K2 "Todo" VALUE 0x0000 /* @ECU_Address@g_msgCore0to2_K2@ */ Record_FLOAT32_IEEE 0 FOCSpdTrq_CM_single_NA -10000.000000 10000.000000 /end CHARACTERISTIC
/begin CHARACTERISTIC g_msgCore0to2_K3 "Todo" VALUE 0x0000 /* @ECU_Address@g_msgCore0to2_K3@ */ Record_FLOAT32_IEEE 0 FOCSpdTrq_CM_single_NA -10000.000000 10000.000000 /end CHARACTERISTIC
/begin CHARACTERISTIC g_msgCore0to2_K3switch "Todo" VALUE 0x0000 /* @ECU_Address@g_msgCore0to2_K3switch@ */ Record_BOOLEAN 0 FOCSpdTrq_CM_logical_NA 0.000000 1.000000 /end CHARACTERISTIC
/begin CHARACTERISTIC g_msgCore0to2_Kvp "Todo" VALUE 0x0000 /* @ECU_Address@g_msgCore0to2_Kvp@ */ Record_FLOAT32_IEEE 0 FOCSpdTrq_CM_single_NA -10000.000000 10000.000000 /end CHARACTERISTIC
/begin CHARACTERISTIC g_msgCore0to2_LPF_coef "Todo" VALUE 0x0000 /* @ECU_Address@g_msgCore0to2_LPF_coef@ */ Record_FLOAT32_IEEE 0 FOCSpdTrq_CM_single_NA -1000.000000 1000.000000 /end CHARACTERISTIC
/begin CHARACTERISTIC g_msgCore0to2_L_coef "Todo" VALUE 0x0000 /* @ECU_Address@g_msgCore0to2_L_coef@ */ Record_FLOAT32_IEEE 0 FOCSpdTrq_CM_single_NA -10000.000000 10000.000000 /end CHARACTERISTIC
/begin CHARACTERISTIC g_msgCore0to2_R_Kr "Todo" VALUE 0x0000 /* @ECU_Address@g_msgCore0to2_R_Kr@ */ Record_FLOAT32_IEEE 0 FOCSpdTrq_CM_single_NA -10000.000000 10000.000000 /end CHARACTERISTIC
/begin CHARACTERISTIC g_msgCore0to2_R_Outputlimit "Todo" VALUE 0x0000 /* @ECU_Address@g_msgCore0to2_R_Outputlimit@ */ Record_FLOAT32_IEEE 0 FOCSpdTrq_CM_single_NA -10000.000000 10000.000000 /end CHARACTERISTIC
/begin CHARACTERISTIC g_msgCore0to2_R_Wc "Todo" VALUE 0x0000 /* @ECU_Address@g_msgCore0to2_R_Wc@ */ Record_FLOAT32_IEEE 0 FOCSpdTrq_CM_single_NA -10000.000000 10000.000000 /end CHARACTERISTIC
/begin CHARACTERISTIC g_msgCore0to2_R_outputGain "Todo" VALUE 0x0000 /* @ECU_Address@g_msgCore0to2_R_outputGain@ */ Record_FLOAT32_IEEE 0 FOCSpdTrq_CM_single_NA -10000.000000 10000.000000 /end CHARACTERISTIC
/begin CHARACTERISTIC g_msgCore0to2_Rswitch "Todo" VALUE 0x0000 /* @ECU_Address@g_msgCore0to2_Rswitch@ */ Record_BOOLEAN 0 FOCSpdTrq_CM_logical_NA 0.000000 1.000000 /end CHARACTERISTIC
/begin CHARACTERISTIC g_msgCore0to2_Trqfix "Todo" VALUE 0x0000 /* @ECU_Address@g_msgCore0to2_Trqfix@ */ Record_BOOLEAN 0 FOCSpdTrq_CM_logical_NA 0.000000 1.000000 /end CHARACTERISTIC
/begin CHARACTERISTIC g_msgCore0to2_alphaLow "Todo" VALUE 0x0000 /* @ECU_Address@g_msgCore0to2_alphaLow@ */ Record_FLOAT32_IEEE 0 FOCSpdTrq_CM_single_NA -10000.000000 10000.000000 /end CHARACTERISTIC
/begin CHARACTERISTIC g_msgCore0to2_betaLow "Todo" VALUE 0x0000 /* @ECU_Address@g_msgCore0to2_betaLow@ */ Record_FLOAT32_IEEE 0 FOCSpdTrq_CM_single_NA -10000.000000 10000.000000 /end CHARACTERISTIC
/begin CHARACTERISTIC g_msgCore0to2_cos_Amp "Todo" VALUE 0x0000 /* @ECU_Address@g_msgCore0to2_cos_Amp@ */ Record_FLOAT32_IEEE 0 FOCSpdTrq_CM_single_NA -1000.000000 1000.000000 /end CHARACTERISTIC
/begin CHARACTERISTIC g_msgCore0to2_cos_frq "Todo" VALUE 0x0000 /* @ECU_Address@g_msgCore0to2_cos_frq@ */ Record_FLOAT32_IEEE 0 FOCSpdTrq_CM_single_NA -1000.000000 1000.000000 /end CHARACTERISTIC
/begin CHARACTERISTIC g_msgCore0to2_cos_phase "Todo" VALUE 0x0000 /* @ECU_Address@g_msgCore0to2_cos_phase@ */ Record_FLOAT32_IEEE 0 FOCSpdTrq_CM_single_NA -1000.000000 1000.000000 /end CHARACTERISTIC
/begin CHARACTERISTIC g_msgCore0to2_frqfix_K "Todo" VALUE 0x0000 /* @ECU_Address@g_msgCore0to2_frqfix_K@ */ Record_FLOAT32_IEEE 0 FOCSpdTrq_CM_single_NA -1000.000000 1000.000000 /end CHARACTERISTIC
/begin CHARACTERISTIC g_msgCore0to2_maxCur2 "Todo" VALUE 0x0000 /* @ECU_Address@g_msgCore0to2_maxCur2@ */ Record_FLOAT32_IEEE 0 FOCSpdTrq_CM_single_NA 0.000000 1000.000000 /end CHARACTERISTIC
/begin CHARACTERISTIC g_msgCore0to2_maxTrq2 "Todo" VALUE 0x0000 /* @ECU_Address@g_msgCore0to2_maxTrq2@ */ Record_FLOAT32_IEEE 0 FOCSpdTrq_CM_single_NA 0.000000 6000.000000 /end CHARACTERISTIC
/begin CHARACTERISTIC g_msgCore0to2_sin_Amp "Todo" VALUE 0x0000 /* @ECU_Address@g_msgCore0to2_sin_Amp@ */ Record_FLOAT32_IEEE 0 FOCSpdTrq_CM_single_NA -1000.000000 1000.000000 /end CHARACTERISTIC
/begin CHARACTERISTIC g_msgCore0to2_sin_frq "Todo" VALUE 0x0000 /* @ECU_Address@g_msgCore0to2_sin_frq@ */ Record_FLOAT32_IEEE 0 FOCSpdTrq_CM_single_NA -1000.000000 1000.000000 /end CHARACTERISTIC
/begin CHARACTERISTIC g_msgCore0to2_sin_phase "Todo" VALUE 0x0000 /* @ECU_Address@g_msgCore0to2_sin_phase@ */ Record_FLOAT32_IEEE 0 FOCSpdTrq_CM_single_NA -1000.000000 1000.000000 /end CHARACTERISTIC
/begin CHARACTERISTIC g_msgCoreoto2_R_woGain "Todo" VALUE 0x0000 /* @ECU_Address@g_msgCoreoto2_R_woGain@ */ Record_FLOAT32_IEEE 0 FOCSpdTrq_CM_single_NA -10000.000000 10000.000000 /end CHARACTERISTIC
/begin MEASUREMENT AntiWindup_Alfa "TODO" FLOAT32_IEEE FOCSpdTrq_CM_single_NA 0 0 -3.4E+38 3.4E+38 ECU_ADDRESS 0x0000 /* @ECU_Address@AntiWindup_Alfa@ */ /end MEASUREMENT
/begin MEASUREMENT AntiWindup_Kpvalue "TODO" FLOAT32_IEEE FOCSpdTrq_CM_single_NA 0 0 -3.4E+38 3.4E+38 ECU_ADDRESS 0x0000 /* @ECU_Address@AntiWindup_Kpvalue@ */ /end MEASUREMENT
/begin MEASUREMENT AntiWindup_Signal "TODO" FLOAT32_IEEE FOCSpdTrq_CM_single_NA 0 0 -3.4E+38 3.4E+38 ECU_ADDRESS 0x0000 /* @ECU_Address@AntiWindup_Signal@ */ /end MEASUREMENT
/begin MEASUREMENT AntiWindup_coef "TODO" FLOAT32_IEEE FOCSpdTrq_CM_single_NA 0 0 -3.4E+38 3.4E+38 ECU_ADDRESS 0x0000 /* @ECU_Address@AntiWindup_coef@ */ /end MEASUREMENT
/begin MEASUREMENT AntiWindup_integral "TODO" FLOAT32_IEEE FOCSpdTrq_CM_single_NA 0 0 -3.4E+38 3.4E+38 ECU_ADDRESS 0x0000 /* @ECU_Address@AntiWindup_integral@ */ /end MEASUREMENT
/begin MEASUREMENT AntiWindup_out "TODO" FLOAT32_IEEE FOCSpdTrq_CM_single_NA 0 0 -3.4E+38 3.4E+38 ECU_ADDRESS 0x0000 /* @ECU_Address@AntiWindup_out@ */ /end MEASUREMENT
/begin MEASUREMENT AsrKp_Calvalue "TODO" FLOAT32_IEEE FOCSpdTrq_CM_single_NA 0 0 -3.4E+38 3.4E+38 ECU_ADDRESS 0x0000 /* @ECU_Address@AsrKp_Calvalue@ */ /end MEASUREMENT
/begin MEASUREMENT Asrintgin_value "TODO" FLOAT32_IEEE FOCSpdTrq_CM_single_NA 0 0 -3.4E+38 3.4E+38 ECU_ADDRESS 0x0000 /* @ECU_Address@Asrintgin_value@ */ /end MEASUREMENT
/begin MEASUREMENT FFKp_value "TODO" FLOAT32_IEEE FOCSpdTrq_CM_single_NA 0 0 -3.4E+38 3.4E+38 ECU_ADDRESS 0x0000 /* @ECU_Address@FFKp_value@ */ /end MEASUREMENT
/begin MEASUREMENT FFintgin_value "TODO" FLOAT32_IEEE FOCSpdTrq_CM_single_NA 0 0 -3.4E+38 3.4E+38 ECU_ADDRESS 0x0000 /* @ECU_Address@FFintgin_value@ */ /end MEASUREMENT
/begin MEASUREMENT FFout "TODO" FLOAT32_IEEE FOCSpdTrq_CM_single_NA 0 0 -3.4E+38 3.4E+38 ECU_ADDRESS 0x0000 /* @ECU_Address@FFout@ */ /end MEASUREMENT
/begin MEASUREMENT FOC_Ki "speedki" FLOAT32_IEEE FOCSpdTrq_CM_single_NA 0 0 -3.4E+38 3.4E+38 ECU_ADDRESS 0x0000 /* @ECU_Address@FOC_Ki@ */ /end MEASUREMENT
/begin MEASUREMENT FOC_Kp "speedkp" FLOAT32_IEEE FOCSpdTrq_CM_single_NA 0 0 -3.4E+38 3.4E+38 ECU_ADDRESS 0x0000 /* @ECU_Address@FOC_Kp@ */ /end MEASUREMENT
/begin MEASUREMENT K1_Limitvalue_P1 "TODO" FLOAT32_IEEE FOCSpdTrq_CM_single_NA 0 0 -3.4E+38 3.4E+38 ECU_ADDRESS 0x0000 /* @ECU_Address@K1_Limitvalue_P1@ */ /end MEASUREMENT
/begin MEASUREMENT K1_value_P1 "TODO" FLOAT32_IEEE FOCSpdTrq_CM_single_NA 0 0 -3.4E+38 3.4E+38 ECU_ADDRESS 0x0000 /* @ECU_Address@K1_value_P1@ */ /end MEASUREMENT
/begin MEASUREMENT K3_value_P1 "TODO" FLOAT32_IEEE FOCSpdTrq_CM_single_NA 0 0 -3.4E+38 3.4E+38 ECU_ADDRESS 0x0000 /* @ECU_Address@K3_value_P1@ */ /end MEASUREMENT
/begin MEASUREMENT LPFcoswave "TODO" FLOAT32_IEEE FOCSpdTrq_CM_single_NA 0 0 -3.4E+38 3.4E+38 ECU_ADDRESS 0x0000 /* @ECU_Address@LPFcoswave@ */ /end MEASUREMENT
/begin MEASUREMENT LPFsinwave "TODO" FLOAT32_IEEE FOCSpdTrq_CM_single_NA 0 0 -3.4E+38 3.4E+38 ECU_ADDRESS 0x0000 /* @ECU_Address@LPFsinwave@ */ /end MEASUREMENT
/begin MEASUREMENT PDFF_Kvp_coef "TODO" FLOAT32_IEEE FOCSpdTrq_CM_single_NA 0 0 -3.4E+38 3.4E+38 ECU_ADDRESS 0x0000 /* @ECU_Address@PDFF_Kvp_coef@ */ /end MEASUREMENT
/begin MEASUREMENT PDFF_SpdrefMuxKff "TODO" FLOAT32_IEEE FOCSpdTrq_CM_single_NA 0 0 -3.4E+38 3.4E+38 ECU_ADDRESS 0x0000 /* @ECU_Address@PDFF_SpdrefMuxKff@ */ /end MEASUREMENT
/begin MEASUREMENT PIout "TODO" FLOAT32_IEEE FOCSpdTrq_CM_single_NA 0 0 -3.4E+38 3.4E+38 ECU_ADDRESS 0x0000 /* @ECU_Address@PIout@ */ /end MEASUREMENT
/begin MEASUREMENT R_finaloutput "TODO" FLOAT32_IEEE FOCSpdTrq_CM_single_NA 0 0 -3.4E+38 3.4E+38 ECU_ADDRESS 0x0000 /* @ECU_Address@R_finaloutput@ */ /end MEASUREMENT
/begin MEASUREMENT R_output "TODO" FLOAT32_IEEE FOCSpdTrq_CM_single_NA 0 0 -3.4E+38 3.4E+38 ECU_ADDRESS 0x0000 /* @ECU_Address@R_output@ */ /end MEASUREMENT
/begin MEASUREMENT R_wo "TODO" FLOAT32_IEEE FOCSpdTrq_CM_single_NA 0 0 -3.4E+38 3.4E+38 ECU_ADDRESS 0x0000 /* @ECU_Address@R_wo@ */ /end MEASUREMENT
/begin MEASUREMENT Trqcomp_Max_P1 "TODO" FLOAT32_IEEE FOCSpdTrq_CM_single_NA 0 0 -3.4E+38 3.4E+38 ECU_ADDRESS 0x0000 /* @ECU_Address@Trqcomp_Max_P1@ */ /end MEASUREMENT
/begin MEASUREMENT Trqcomp_Min_P1 "TODO" FLOAT32_IEEE FOCSpdTrq_CM_single_NA 0 0 -3.4E+38 3.4E+38 ECU_ADDRESS 0x0000 /* @ECU_Address@Trqcomp_Min_P1@ */ /end MEASUREMENT
/begin MEASUREMENT alpha "TODO" FLOAT32_IEEE FOCSpdTrq_CM_single_NA 0 0 -3.4E+38 3.4E+38 ECU_ADDRESS 0x0000 /* @ECU_Address@alpha@ */ /end MEASUREMENT
/begin MEASUREMENT beta "TODO" FLOAT32_IEEE FOCSpdTrq_CM_single_NA 0 0 -3.4E+38 3.4E+38 ECU_ADDRESS 0x0000 /* @ECU_Address@beta@ */ /end MEASUREMENT
/begin MEASUREMENT beta_signal "TODO" FLOAT32_IEEE FOCSpdTrq_CM_single_NA 0 0 -3.4E+38 3.4E+38 ECU_ADDRESS 0x0000 /* @ECU_Address@beta_signal@ */ /end MEASUREMENT
/begin MEASUREMENT comp_P1 "TODO" FLOAT32_IEEE FOCSpdTrq_CM_single_NA 0 0 -3.4E+38 3.4E+38 ECU_ADDRESS 0x0000 /* @ECU_Address@comp_P1@ */ /end MEASUREMENT
/begin MEASUREMENT cosfixtrq "TODO" FLOAT32_IEEE FOCSpdTrq_CM_single_NA 0 0 -3.4E+38 3.4E+38 ECU_ADDRESS 0x0000 /* @ECU_Address@cosfixtrq@ */ /end MEASUREMENT
/begin MEASUREMENT coswave "TODO" FLOAT32_IEEE FOCSpdTrq_CM_single_NA 0 0 -3.4E+38 3.4E+38 ECU_ADDRESS 0x0000 /* @ECU_Address@coswave@ */ /end MEASUREMENT
/begin MEASUREMENT err_thresh_high "TODO" FLOAT32_IEEE FOCSpdTrq_CM_single_NA 0 0 -3.4E+38 3.4E+38 ECU_ADDRESS 0x0000 /* @ECU_Address@err_thresh_high@ */ /end MEASUREMENT
/begin MEASUREMENT err_thresh_low "TODO" FLOAT32_IEEE FOCSpdTrq_CM_single_NA 0 0 -3.4E+38 3.4E+38 ECU_ADDRESS 0x0000 /* @ECU_Address@err_thresh_low@ */ /end MEASUREMENT
/begin MEASUREMENT sinfixtrq "TODO" FLOAT32_IEEE FOCSpdTrq_CM_single_NA 0 0 -3.4E+38 3.4E+38 ECU_ADDRESS 0x0000 /* @ECU_Address@sinfixtrq@ */ /end MEASUREMENT
/begin MEASUREMENT sinwave "TODO" FLOAT32_IEEE FOCSpdTrq_CM_single_NA 0 0 -3.4E+38 3.4E+38 ECU_ADDRESS 0x0000 /* @ECU_Address@sinwave@ */ /end MEASUREMENT
/begin MEASUREMENT total_fixtrq "TODO" FLOAT32_IEEE FOCSpdTrq_CM_single_NA 0 0 -3.4E+38 3.4E+38 ECU_ADDRESS 0x0000 /* @ECU_Address@total_fixtrq@ */ /end MEASUREMENT
/begin MEASUREMENT wave_P1 "TODO" FLOAT32_IEEE FOCSpdTrq_CM_single_NA 0 0 -3.4E+38 3.4E+38 ECU_ADDRESS 0x0000 /* @ECU_Address@wave_P1@ */ /end MEASUREMENT
/begin COMPU_METHOD FOCSpdTrq_CM_logical_NA "Q = V" RAT_FUNC "%1.0" "NA" COEFFS 0 1 0 0 0 1 /end COMPU_METHOD
/begin COMPU_METHOD FOCSpdTrq_CM_single_A "Q = V" RAT_FUNC "%8.6" "A" COEFFS 0 1 0 0 0 1 /end COMPU_METHOD
/begin COMPU_METHOD FOCSpdTrq_CM_single_NA "Q = V" RAT_FUNC "%8.6" "NA" COEFFS 0 1 0 0 0 1 /end COMPU_METHOD
/begin RECORD_LAYOUT Record_BOOLEAN FNC_VALUES 1 UBYTE COLUMN_DIR DIRECT /end RECORD_LAYOUT
/begin RECORD_LAYOUT Record_FLOAT32_IEEE FNC_VALUES 1 FLOAT32_IEEE COLUMN_DIR DIRECT /end RECORD_LAYOUT
/* Record Layouts for Lookup Tables in Standard Axis format */
/begin RECORD_LAYOUT cphaseST_P1 AXIS_PTS_X 1 FLOAT32_IEEE INDEX_INCR DIRECT FNC_VALUES 2 FLOAT32_IEEE COLUMN_DIR DIRECT /end RECORD_LAYOUT
/begin RECORD_LAYOUT crippleST_P1 AXIS_PTS_X 1 FLOAT32_IEEE INDEX_INCR DIRECT FNC_VALUES 2 FLOAT32_IEEE COLUMN_DIR DIRECT /end RECORD_LAYOUT
/begin GROUP FOCSpdTrq "FOCSpdTrq" /* Root */ ROOT /begin SUB_GROUP FOCSpdTrq_Subsystem /end SUB_GROUP /end GROUP
/begin GROUP FOCSpdTrq_Subsystem "FOCSpdTrq/Subsystem"
 /begin SUB_GROUP FOCSpdTrq_Subsystem_Speed_Control FOCSpdTrq_Subsystem_Subsystem1 FOCSpdTrq_Subsystem_Torque_Control /end SUB_GROUP
 /begin REF_CHARACTERISTIC g_msgCore0to2_maxTrq2 /end REF_CHARACTERISTIC
/end GROUP
/begin GROUP FOCSpdTrq_Subsystem_Speed_Control "FOCSpdTrq/Subsystem/Speed Control"
 /begin SUB_GROUP FOCSpdTrq_Subsystem_Speed_Control_PT1_1 FOCSpdTrq_Subsystem_Speed_Control_PT1_2 FOCSpdTrq_Subsystem_Speed_Control_Saturation_Dynamic FOCSpdTrq_Subsystem_Speed_Control_Subsystem /end SUB_GROUP
 /begin REF_CHARACTERISTIC cphase_T_P1 cripple_T_P1 g_msgCore0to2_Asrctrlmode g_msgCore0to2_CalibEn2 g_msgCore0to2_HFcoef g_msgCore0to2_H_coef g_msgCore0to2_K1 g_msgCore0to2_K1switch g_msgCore0to2_K2 g_msgCore0to2_K3 g_msgCore0to2_K3switch g_msgCore0to2_Kvp g_msgCore0to2_LPF_coef g_msgCore0to2_L_coef g_msgCore0to2_R_Kr g_msgCore0to2_R_Outputlimit g_msgCore0to2_R_Wc g_msgCore0to2_R_outputGain g_msgCore0to2_Rswitch g_msgCore0to2_Trqfix g_msgCore0to2_alphaLow g_msgCore0to2_betaLow g_msgCore0to2_cos_Amp g_msgCore0to2_cos_frq g_msgCore0to2_cos_phase g_msgCore0to2_frqfix_K g_msgCore0to2_maxTrq2 g_msgCore0to2_sin_Amp g_msgCore0to2_sin_frq g_msgCore0to2_sin_phase g_msgCoreoto2_R_woGain /end REF_CHARACTERISTIC
 /begin REF_MEASUREMENT AntiWindup_Alfa AntiWindup_Kpvalue AntiWindup_Signal AntiWindup_coef AntiWindup_integral AntiWindup_out AsrKp_Calvalue Asrintgin_value FFKp_value FFintgin_value FFout FOC_Ki FOC_Kp K1_Limitvalue_P1 K1_value_P1 K3_value_P1 PDFF_Kvp_coef PDFF_SpdrefMuxKff PIout R_finaloutput R_output R_wo Trqcomp_Max_P1 Trqcomp_Min_P1 alpha beta beta_signal comp_P1 cosfixtrq coswave err_thresh_high err_thresh_low sinfixtrq sinwave total_fixtrq wave_P1 /end REF_MEASUREMENT
/end GROUP
/begin GROUP FOCSpdTrq_Subsystem_Speed_Control_PT1_1 "FOCSpdTrq/Subsystem/Speed Control/PT1_1" /begin REF_MEASUREMENT LPFsinwave /end REF_MEASUREMENT /end GROUP
/begin GROUP FOCSpdTrq_Subsystem_Speed_Control_PT1_2 "FOCSpdTrq/Subsystem/Speed Control/PT1_2" /begin REF_MEASUREMENT LPFcoswave /end REF_MEASUREMENT /end GROUP
/begin GROUP FOCSpdTrq_Subsystem_Speed_Control_Saturation_Dynamic "FOCSpdTrq/Subsystem/Speed Control/Saturation
Dynamic" /begin REF_MEASUREMENT K1_Limitvalue_P1 K1_value_P1 Trqcomp_Max_P1 Trqcomp_Min_P1 /end REF_MEASUREMENT /end GROUP
/begin GROUP FOCSpdTrq_Subsystem_Speed_Control_Subsystem "FOCSpdTrq/Subsystem/Speed Control/Subsystem"
 /begin REF_CHARACTERISTIC f32_P_SpeedPiMaxRatio f32_P_SpeedPiMinRatio g_msgCore0to2_maxCur2 /end REF_CHARACTERISTIC
/end GROUP
/begin GROUP FOCSpdTrq_Subsystem_Subsystem1 "FOCSpdTrq/Subsystem/Subsystem1"
 /begin REF_CHARACTERISTIC g_msgCore0to2_AsrKpHi g_msgCore0to2_AsrKpLo g_msgCore0to2_AsrKpZero g_msgCore0to2_AsrSwtHiRpm g_msgCore0to2_AsrSwtLoRpm g_msgCore0to2_AsrTiHi g_msgCore0to2_AsrTiLo g_msgCore0to2_AsrTiZero g_msgCore0to2_CalibEn2 g_msgCore0to2_maxCur2 g_msgCore0to2_maxTrq2 /end REF_CHARACTERISTIC
 /begin REF_MEASUREMENT FOC_Ki FOC_Kp /end REF_MEASUREMENT
/end GROUP
/begin GROUP FOCSpdTrq_Subsystem_Torque_Control "FOCSpdTrq/Subsystem/Torque Control"
 /begin SUB_GROUP FOCSpdTrq_Subsystem_Torque_Control_SpdNegLimit FOCSpdTrq_Subsystem_Torque_Control_SpdPosLimit /end SUB_GROUP
/end GROUP
/begin GROUP FOCSpdTrq_Subsystem_Torque_Control_SpdNegLimit "FOCSpdTrq/Subsystem/Torque Control/SpdNegLimit" /begin REF_CHARACTERISTIC f32_P_SpdNeglimit_rpm /end REF_CHARACTERISTIC /begin REF_MEASUREMENT FOC_Ki FOC_Kp /end REF_MEASUREMENT /end GROUP
/begin GROUP FOCSpdTrq_Subsystem_Torque_Control_SpdPosLimit "FOCSpdTrq/Subsystem/Torque Control/SpdPosLimit" /begin REF_CHARACTERISTIC f32_P_SpdPoslimit_rpm /end REF_CHARACTERISTIC /begin REF_MEASUREMENT FOC_Ki FOC_Kp /end REF_MEASUREMENT /end GROUP
/end MODULE
/end PROJECT
/* (add any file trailer comments here) */
/* EOF FOCSpdTrq.a2l*/
