/******************************************************************************
* ASAP2 file: pmsmfoc.a2l
* Code generation for model "pmsmfoc".
* Model version : 11.145
* Simulink Coder version : 10.6 R2022b
* C source code generated on : Tue Jul 28 23:07:01 2026
* Target selection: ert.tlc
* Embedded hardware selection: Infineon->TriCore
* Code generation objectives: Unspecified
* Validation result: Not run
* (add additional file header information here)
******************************************************************************/ ASAP2_VERSION 1 31
/* Version 1.31 */
/begin PROJECT ProjectName "Project Comment Goes Here"
/begin HEADER "Header Comments go here" /end HEADER
/begin MODULE ModuleName "Module Comment Goes Here"
/begin MOD_PAR "MOD PAR Comment Goes Here" /end MOD_PAR
/begin MOD_COMMON "Mod Common Comment Here" BYTE_ORDER MSB_LAST ALIGNMENT_BYTE 1 ALIGNMENT_WORD 2 ALIGNMENT_LONG 4 ALIGNMENT_FLOAT32_IEEE 4 ALIGNMENT_FLOAT64_IEEE 4 /end MOD_COMMON
/begin CHARACTERISTIC ExFeedBack_T "flux weakening control -exfeedback current" MAP 0x0000 /* @ECU_Address@ExFeedBack_T@ */ ExFeedBackST 0 FOC_CM_single_NA -400.000000 0.000000
 /begin AXIS_DESCR STD_AXIS PMC_PsiMax FOC_CM_single_Nm 10 0.000000 500.000000 /end AXIS_DESCR
 /begin AXIS_DESCR STD_AXIS NO_INPUT_QUANTITY FOC_CM_single_NA 21 0.000000 17.500000 /end AXIS_DESCR
/end CHARACTERISTIC
/begin CHARACTERISTIC FFW_enable "" VALUE 0x0000 /* @ECU_Address@FFW_enable@ */ Record_FLOAT32_IEEE 0 FOC_CM_single_NA 0.000000 1.000000 /end CHARACTERISTIC
/begin CHARACTERISTIC IdROL_C "" VALUE 0x0000 /* @ECU_Address@IdROL_C@ */ Record_FLOAT32_IEEE 0 CDD_ISP_CM_single_NA 0.000000 50.000000 /end CHARACTERISTIC
/begin CHARACTERISTIC MTPA_T "MTPA curve with torque and rotor temperature" MAP 0x0000 /* @ECU_Address@MTPA_T@ */ MTPAST 0 FOC_CM_single_A -450.000000 0.000000
 /begin AXIS_DESCR STD_AXIS FOCpmsmfoc_rtDWork.Model2_o1 FOC_CM_single_degC 5 -40.000000 200.000000 /end AXIS_DESCR
 /begin AXIS_DESCR STD_AXIS NO_INPUT_QUANTITY FOC_CM_single_Nm 21 0.000000 400.000000 /end AXIS_DESCR
/end CHARACTERISTIC
/begin CHARACTERISTIC PWMFrqSwitch_C "" VALUE 0x0000 /* @ECU_Address@PWMFrqSwitch_C@ */ Record_BOOLEAN 0 FOC_CM_logical_NA 0.000000 1.000000 /end CHARACTERISTIC
/begin CHARACTERISTIC SC_Ld_P "" VALUE 0x0000 /* @ECU_Address@SC_Ld_P@ */ Record_FLOAT32_IEEE 0 FOC_CM_single_H 0.000000 0.050000 /end CHARACTERISTIC
/begin CHARACTERISTIC SC_Lq_P "" VALUE 0x0000 /* @ECU_Address@SC_Lq_P@ */ Record_FLOAT32_IEEE 0 FOC_CM_single_H 0.000000 0.050000 /end CHARACTERISTIC
/begin CHARACTERISTIC SC_Psi_P "" VALUE 0x0000 /* @ECU_Address@SC_Psi_P@ */ Record_FLOAT32_IEEE 0 FOC_CM_single_NA 0.000000 1.000000 /end CHARACTERISTIC
/begin CHARACTERISTIC SC_pRsv_P "" VALUE 0x0000 /* @ECU_Address@SC_pRsv_P@ */ Record_FLOAT32_IEEE 0 CDD_ISP_CM_single_NA 0.000000 32.000000 /end CHARACTERISTIC
/begin CHARACTERISTIC SC_p_P "" VALUE 0x0000 /* @ECU_Address@SC_p_P@ */ Record_FLOAT32_IEEE 0 CDD_ISP_CM_single_NA 0.000000 32.000000 /end CHARACTERISTIC
/begin CHARACTERISTIC agNegTrans_C "" VALUE 0x0000 /* @ECU_Address@agNegTrans_C@ */ Record_SWORD 0 CDD_ISP_CM_int16_NA -1.000000 1.000000 /end CHARACTERISTIC
/begin CHARACTERISTIC cLdAdptMon_T "Lqwith id and iq" MAP 0x0000 /* @ECU_Address@cLdAdptMon_T@ */ cLdAdptMonST 0 FOC_CM_single_NA 0.000000 1.100000
 /begin AXIS_DESCR STD_AXIS NO_INPUT_QUANTITY FOC_CM_single_A 25 -550.000000 550.000000 /end AXIS_DESCR
 /begin AXIS_DESCR STD_AXIS ISP_iQaFild FOC_CM_single_A 61 -550.000000 550.000000 /end AXIS_DESCR
/end CHARACTERISTIC
/begin CHARACTERISTIC cLqAdptMon_T "Lqwith id and iq" MAP 0x0000 /* @ECU_Address@cLqAdptMon_T@ */ cLqAdptMonST 0 FOC_CM_single_NA 0.000000 1.100000
 /begin AXIS_DESCR STD_AXIS NO_INPUT_QUANTITY FOC_CM_single_A 25 -550.000000 550.000000 /end AXIS_DESCR
 /begin AXIS_DESCR STD_AXIS ISP_iQaFild FOC_CM_single_A 61 -550.000000 550.000000 /end AXIS_DESCR
/end CHARACTERISTIC
/begin CHARACTERISTIC cPsiIsqAdptMot_TT "flux with Iq" CURVE 0x0000 /* @ECU_Address@cPsiIsqAdptMot_TT@ */ cPsiIsqAdptMotSTT 0 FOC_CM_single_NA 0.000000 1.100000
 /begin AXIS_DESCR STD_AXIS ISP_iQaFild FOC_CM_single_A 121 -550.000000 550.000000 /end AXIS_DESCR
/end CHARACTERISTIC
/begin CHARACTERISTIC f32_P_AngleCompCur "" VALUE 0x0000 /* @ECU_Address@f32_P_AngleCompCur@ */ Record_FLOAT32_IEEE 0 FOC_CM_single_NA -5.000000 5.000000 /end CHARACTERISTIC
/begin CHARACTERISTIC f32_P_AngleCompVol "" VALUE 0x0000 /* @ECU_Address@f32_P_AngleCompVol@ */ Record_FLOAT32_IEEE 0 FOC_CM_single_NA -5.000000 5.000000 /end CHARACTERISTIC
/begin CHARACTERISTIC f32_P_Coef "" VALUE 0x0000 /* @ECU_Address@f32_P_Coef@ */ Record_FLOAT32_IEEE 0 FOC_CM_single_NA 0.000000 0.500000 /end CHARACTERISTIC
/begin CHARACTERISTIC f32_P_Modulation "" VALUE 0x0000 /* @ECU_Address@f32_P_Modulation@ */ Record_FLOAT32_IEEE 0 FOC_CM_single_NA 0.000000 1.100000 /end CHARACTERISTIC
/begin CHARACTERISTIC f32_SpeedFltCoef "" VALUE 0x0000 /* @ECU_Address@f32_SpeedFltCoef@ */ Record_FLOAT32_IEEE 0 CDD_ISP_CM_single_NA 0.000000 4000.000000 /end CHARACTERISTIC
/begin CHARACTERISTIC facAdc2iPh_C "" VALUE 0x0000 /* @ECU_Address@facAdc2iPh_C@ */ Record_FLOAT32_IEEE 0 CDD_ISP_CM_single_NA -0.600000 0.600000 /end CHARACTERISTIC
/begin CHARACTERISTIC facAdc2uDclnk_C "" VALUE 0x0000 /* @ECU_Address@facAdc2uDclnk_C@ */ Record_FLOAT32_IEEE 0 CDD_ISP_CM_single_NA 0.000000 0.990000 /end CHARACTERISTIC
/begin CHARACTERISTIC g_msgCore0to2_AcrKi "" VALUE 0x0000 /* @ECU_Address@g_msgCore0to2_AcrKi@ */ Record_FLOAT32_IEEE 0 FOC_CM_single_NA 0.000000 4000.000000 /end CHARACTERISTIC
/begin CHARACTERISTIC g_msgCore0to2_AcrKiStb "" VALUE 0x0000 /* @ECU_Address@g_msgCore0to2_AcrKiStb@ */ Record_FLOAT32_IEEE 0 FOC_CM_single_NA 0.000000 4000.000000 /end CHARACTERISTIC
/begin CHARACTERISTIC g_msgCore0to2_AcrKp "" VALUE 0x0000 /* @ECU_Address@g_msgCore0to2_AcrKp@ */ Record_FLOAT32_IEEE 0 FOC_CM_single_NA 0.000000 1000.000000 /end CHARACTERISTIC
/begin CHARACTERISTIC g_msgCore0to2_AcrKpStb "" VALUE 0x0000 /* @ECU_Address@g_msgCore0to2_AcrKpStb@ */ Record_FLOAT32_IEEE 0 FOC_CM_single_NA 0.000000 1000.000000 /end CHARACTERISTIC
/begin CHARACTERISTIC g_msgCore0to2_AcrSwtHiRpm "" VALUE 0x0000 /* @ECU_Address@g_msgCore0to2_AcrSwtHiRpm@ */ Record_FLOAT32_IEEE 0 FOC_CM_single_NA 0.000000 6000.000000 /end CHARACTERISTIC
/begin CHARACTERISTIC g_msgCore0to2_AcrSwtLoRpm "" VALUE 0x0000 /* @ECU_Address@g_msgCore0to2_AcrSwtLoRpm@ */ Record_FLOAT32_IEEE 0 FOC_CM_single_NA 0.000000 6000.000000 /end CHARACTERISTIC
/begin CHARACTERISTIC g_msgCore0to2_AfrKp "" VALUE 0x0000 /* @ECU_Address@g_msgCore0to2_AfrKp@ */ Record_FLOAT32_IEEE 0 FOC_CM_single_NA 0.000000 30.000000 /end CHARACTERISTIC
/begin CHARACTERISTIC g_msgCore0to2_AfrTi "" VALUE 0x0000 /* @ECU_Address@g_msgCore0to2_AfrTi@ */ Record_FLOAT32_IEEE 0 FOC_CM_single_NA 0.000000 1.000000 /end CHARACTERISTIC
/begin CHARACTERISTIC g_msgCore0to2_CalibEn "" VALUE 0x0000 /* @ECU_Address@g_msgCore0to2_CalibEn@ */ Record_BOOLEAN 0 FOC_CM_logical_NA 0.000000 1.000000 /end CHARACTERISTIC
/begin CHARACTERISTIC g_msgCore0to2_DecoupleEn "" VALUE 0x0000 /* @ECU_Address@g_msgCore0to2_DecoupleEn@ */ Record_FLOAT32_IEEE 0 FOC_CM_single_NA 0.000000 1.000000 /end CHARACTERISTIC
/begin CHARACTERISTIC g_msgCore0to2_FFW_Gain "" VALUE 0x0000 /* @ECU_Address@g_msgCore0to2_FFW_Gain@ */ Record_FLOAT32_IEEE 0 FOC_CM_single_NA 0.000000 1.000000 /end CHARACTERISTIC
/begin CHARACTERISTIC g_msgCore0to2_L1 "" VALUE 0x0000 /* @ECU_Address@g_msgCore0to2_L1@ */ Record_FLOAT32_IEEE 0 CDD_ISP_CM_single_NA -40000.000000 40000.000000 /end CHARACTERISTIC
/begin CHARACTERISTIC g_msgCore0to2_L2 "" VALUE 0x0000 /* @ECU_Address@g_msgCore0to2_L2@ */ Record_FLOAT32_IEEE 0 CDD_ISP_CM_single_NA -40000.000000 40000.000000 /end CHARACTERISTIC
/begin CHARACTERISTIC g_msgCore0to2_MTPA_Gain "" VALUE 0x0000 /* @ECU_Address@g_msgCore0to2_MTPA_Gain@ */ Record_FLOAT32_IEEE 0 FOC_CM_single_NA 0.000000 1.000000 /end CHARACTERISTIC
/begin CHARACTERISTIC g_msgCore0to2_N111 "" VALUE 0x0000 /* @ECU_Address@g_msgCore0to2_N111@ */ Record_FLOAT32_IEEE 0 CDD_ISP_CM_single_NA -40000.000000 40000.000000 /end CHARACTERISTIC
/begin CHARACTERISTIC g_msgCore0to2_N222 "" VALUE 0x0000 /* @ECU_Address@g_msgCore0to2_N222@ */ Record_FLOAT32_IEEE 0 CDD_ISP_CM_single_NA -40000.000000 40000.000000 /end CHARACTERISTIC
/begin CHARACTERISTIC g_msgCore0to2_arc_dd_fi "" VALUE 0x0000 /* @ECU_Address@g_msgCore0to2_arc_dd_fi@ */ Record_FLOAT32_IEEE 0 FOC_CM_single_NA 0.000000 1.000000 /end CHARACTERISTIC
/begin CHARACTERISTIC g_msgCore0to2_clpwitch "" VALUE 0x0000 /* @ECU_Address@g_msgCore0to2_clpwitch@ */ Record_BOOLEAN 0 FOC_CM_logical_NA 0.000000 1.000000 /end CHARACTERISTIC
/begin CHARACTERISTIC g_msgCore0to2_depth "" VALUE 0x0000 /* @ECU_Address@g_msgCore0to2_depth@ */ Record_FLOAT32_IEEE 0 CDD_ISP_CM_single_NA -40000.000000 40000.000000 /end CHARACTERISTIC
/begin CHARACTERISTIC g_msgCore0to2_detlaAngle_single "" VALUE 0x0000 /* @ECU_Address@g_msgCore0to2_detlaAngle_single@ */ Record_FLOAT32_IEEE 0 CDD_ISP_CM_single_NA -40000.000000 40000.000000 /end CHARACTERISTIC
/begin CHARACTERISTIC g_msgCore0to2_dqLpf "" VALUE 0x0000 /* @ECU_Address@g_msgCore0to2_dqLpf@ */ Record_FLOAT32_IEEE 0 FOC_CM_single_NA 0.000000 1.000000 /end CHARACTERISTIC
/begin CHARACTERISTIC g_msgCore0to2_dqLpfSpdCoef "" VALUE 0x0000 /* @ECU_Address@g_msgCore0to2_dqLpfSpdCoef@ */ Record_FLOAT32_IEEE 0 FOC_CM_single_NA 0.000000 1.000000 /end CHARACTERISTIC
/begin CHARACTERISTIC g_msgCore0to2_fbw "" VALUE 0x0000 /* @ECU_Address@g_msgCore0to2_fbw@ */ Record_FLOAT32_IEEE 0 CDD_ISP_CM_single_NA -40000.000000 40000.000000 /end CHARACTERISTIC
/begin CHARACTERISTIC g_msgCore0to2_linearKpEn "" VALUE 0x0000 /* @ECU_Address@g_msgCore0to2_linearKpEn@ */ Record_BOOLEAN 0 FOC_CM_logical_NA 0.000000 1.000000 /end CHARACTERISTIC
/begin CHARACTERISTIC g_msgCore0to2_maxCur "" VALUE 0x0000 /* @ECU_Address@g_msgCore0to2_maxCur@ */ Record_FLOAT32_IEEE 0 FOC_CM_single_NA 0.000000 1000.000000 /end CHARACTERISTIC
/begin CHARACTERISTIC g_msgCore0to2_maxFwcCurRatio "" VALUE 0x0000 /* @ECU_Address@g_msgCore0to2_maxFwcCurRatio@ */ Record_FLOAT32_IEEE 0 FOC_CM_single_NA 0.000000 100.000000 /end CHARACTERISTIC
/begin CHARACTERISTIC g_msgCore0to2_motorseq "" VALUE 0x0000 /* @ECU_Address@g_msgCore0to2_motorseq@ */ Record_BOOLEAN 0 FOC_CM_logical_NA 0.000000 1.000000 /end CHARACTERISTIC
/begin CHARACTERISTIC g_msgCore0to2_pwmFrqSet "" VALUE 0x0000 /* @ECU_Address@g_msgCore0to2_pwmFrqSet@ */ Record_FLOAT32_IEEE 0 FOC_CM_single_NA 0.000000 20000.000000 /end CHARACTERISTIC
/begin CHARACTERISTIC g_msgCore0to2_spdswitch "" VALUE 0x0000 /* @ECU_Address@g_msgCore0to2_spdswitch@ */ Record_FLOAT32_IEEE 0 FOC_CM_single_NA -40000.000000 40000.000000 /end CHARACTERISTIC
/begin CHARACTERISTIC g_msgCore0to2_wb "" VALUE 0x0000 /* @ECU_Address@g_msgCore0to2_wb@ */ Record_FLOAT32_IEEE 0 CDD_ISP_CM_single_NA -40000.000000 40000.000000 /end CHARACTERISTIC
/begin CHARACTERISTIC iPhaMax_C "" VALUE 0x0000 /* @ECU_Address@iPhaMax_C@ */ Record_FLOAT32_IEEE 0 CDD_ISP_CM_single_A -1000.000000 1000.000000 /end CHARACTERISTIC
/begin CHARACTERISTIC iPhaMin_C "" VALUE 0x0000 /* @ECU_Address@iPhaMin_C@ */ Record_FLOAT32_IEEE 0 CDD_ISP_CM_single_A -1000.000000 1000.000000 /end CHARACTERISTIC
/begin CHARACTERISTIC offsAgRtrElec_C "" VALUE 0x0000 /* @ECU_Address@offsAgRtrElec_C@ */ Record_SWORD 0 CDD_ISP_CM_int16_NA -32768.000000 32767.000000 /end CHARACTERISTIC
/begin CHARACTERISTIC rotatedirection_C "" VALUE 0x0000 /* @ECU_Address@rotatedirection_C@ */ Record_UWORD 0 CDD_ISP_CM_uint16_NA 0.000000 1.000000 /end CHARACTERISTIC
/begin CHARACTERISTIC tauUdcPT1_C "" VALUE 0x0000 /* @ECU_Address@tauUdcPT1_C@ */ Record_FLOAT32_IEEE 0 CDD_ISP_CM_single_s 0.000000 1.000000 /end CHARACTERISTIC
/begin CHARACTERISTIC u16_P_MotorPair "" VALUE 0x0000 /* @ECU_Address@u16_P_MotorPair@ */ Record_FLOAT32_IEEE 0 FOC_CM_single_NA 0.000000 8.000000 /end CHARACTERISTIC
/begin CHARACTERISTIC uDcMax_C "" VALUE 0x0000 /* @ECU_Address@uDcMax_C@ */ Record_FLOAT32_IEEE 0 CDD_ISP_CM_single_V 0.000000 1000.000000 /end CHARACTERISTIC
/begin CHARACTERISTIC uDcMin_C "" VALUE 0x0000 /* @ECU_Address@uDcMin_C@ */ Record_FLOAT32_IEEE 0 CDD_ISP_CM_single_V -1.000000 1000.000000 /end CHARACTERISTIC
/begin MEASUREMENT B "TODO" FLOAT32_IEEE CDD_ISP_CM_single_NA 0 0 -3.4E+38 3.4E+38 ECU_ADDRESS 0x0000 /* @ECU_Address@B@ */
 /begin IF_DATA XCP
  /begin DAQ_EVENT VARIABLE /begin DEFAULT_EVENT_LIST EVENT 0x0000 /end DEFAULT_EVENT_LIST /end DAQ_EVENT
 /end IF_DATA
/end MEASUREMENT
/begin MEASUREMENT FOC_AcrKpCalOpt "TODO" FLOAT32_IEEE FOC_CM_single_NA 0 0 -3.4E+38 3.4E+38 ECU_ADDRESS 0x0000 /* @ECU_Address@FOC_AcrKpCalOpt@ */
 /begin IF_DATA XCP
  /begin DAQ_EVENT VARIABLE /begin DEFAULT_EVENT_LIST EVENT 0x0000 /end DEFAULT_EVENT_LIST /end DAQ_EVENT
 /end IF_DATA
/end MEASUREMENT
/begin MEASUREMENT FOC_CurKp "curkp" FLOAT32_IEEE FOC_CM_single_NA 0 0 -3.4E+38 3.4E+38 ECU_ADDRESS 0x0000 /* @ECU_Address@FOC_CurKp@ */
 /begin IF_DATA XCP
  /begin DAQ_EVENT VARIABLE /begin DEFAULT_EVENT_LIST EVENT 0x0000 /end DEFAULT_EVENT_LIST /end DAQ_EVENT
 /end IF_DATA
/end MEASUREMENT
/begin MEASUREMENT ISP_agRoughCal "Rough Calibrated output offset rotor angle" SWORD CDD_ISP_CM_int16_NA 0 0 -32768.000000 32767.000000 ECU_ADDRESS 0x0000 /* @ECU_Address@ISP_agRoughCal@ */
 /begin IF_DATA XCP
  /begin DAQ_EVENT VARIABLE /begin DEFAULT_EVENT_LIST EVENT 0x0000 /end DEFAULT_EVENT_LIST /end DAQ_EVENT
 /end IF_DATA
/end MEASUREMENT
/begin MEASUREMENT ISP_agRtrElec "Electric angle of rotor" SWORD CDD_ISP_CM_int16_NA 0 0 -32768.000000 32767.000000 ECU_ADDRESS 0x0000 /* @ECU_Address@ISP_agRtrElec@ */
 /begin IF_DATA XCP
  /begin DAQ_EVENT VARIABLE /begin DEFAULT_EVENT_LIST EVENT 0x0000 /end DEFAULT_EVENT_LIST /end DAQ_EVENT
 /end IF_DATA
/end MEASUREMENT
/begin MEASUREMENT ISP_agRtrElecAtan2 "Electric angle of rotor calculated by atan2" SWORD CDD_ISP_CM_int16_NA 0 0 -32768.000000 32767.000000 ECU_ADDRESS 0x0000 /* @ECU_Address@ISP_agRtrElecAtan2@ */
 /begin IF_DATA XCP
  /begin DAQ_EVENT VARIABLE /begin DEFAULT_EVENT_LIST EVENT 0x0000 /end DEFAULT_EVENT_LIST /end DAQ_EVENT
 /end IF_DATA
/end MEASUREMENT
/begin MEASUREMENT ISP_agRtrPoleTrans "Resolver electric angle transit to motor electric angle" SWORD CDD_ISP_CM_int16_NA 0 0 -32768.000000 32767.000000 ECU_ADDRESS 0x0000 /* @ECU_Address@ISP_agRtrPoleTrans@ */
 /begin IF_DATA XCP
  /begin DAQ_EVENT VARIABLE /begin DEFAULT_EVENT_LIST EVENT 0x0000 /end DEFAULT_EVENT_LIST /end DAQ_EVENT
 /end IF_DATA
/end MEASUREMENT
/begin MEASUREMENT ISP_frqElec "Electric frequency of rotor" FLOAT32_IEEE CDD_ISP_CM_single_Hz 0 0 -2000.000000 2000.000000 ECU_ADDRESS 0x0000 /* @ECU_Address@ISP_frqElec@ */
 /begin IF_DATA XCP
  /begin DAQ_EVENT VARIABLE /begin DEFAULT_EVENT_LIST EVENT 0x0000 /end DEFAULT_EVENT_LIST /end DAQ_EVENT
 /end IF_DATA
/end MEASUREMENT
/begin MEASUREMENT ISP_frqElecCaln "Electric frequency of rotor by atan2 calculate" FLOAT32_IEEE CDD_ISP_CM_single_Hz 0 0 -2000.000000 2000.000000 ECU_ADDRESS 0x0000 /* @ECU_Address@ISP_frqElecCaln@ */
 /begin IF_DATA XCP
  /begin DAQ_EVENT VARIABLE /begin DEFAULT_EVENT_LIST EVENT 0x0000 /end DEFAULT_EVENT_LIST /end DAQ_EVENT
 /end IF_DATA
/end MEASUREMENT
/begin MEASUREMENT ISP_iDaFild "d-axis filtered current,A" FLOAT32_IEEE FOC_CM_single_A 0 0 -1000.000000 1000.000000 ECU_ADDRESS 0x0000 /* @ECU_Address@ISP_iDaFild@ */
 /begin IF_DATA XCP
  /begin DAQ_EVENT VARIABLE /begin DEFAULT_EVENT_LIST EVENT 0x0000 /end DEFAULT_EVENT_LIST /end DAQ_EVENT
 /end IF_DATA
/end MEASUREMENT
/begin MEASUREMENT ISP_iDcFlt "Calculated Dc link current" FLOAT32_IEEE CDD_ISP_CM_single_A 0 0 -1000.000000 1000.000000 ECU_ADDRESS 0x0000 /* @ECU_Address@ISP_iDcFlt@ */
 /begin IF_DATA XCP
  /begin DAQ_EVENT VARIABLE /begin DEFAULT_EVENT_LIST EVENT 0x0000 /end DEFAULT_EVENT_LIST /end DAQ_EVENT
 /end IF_DATA
/end MEASUREMENT
/begin MEASUREMENT ISP_iPhaU "U phase current, A" FLOAT32_IEEE CDD_ISP_CM_single_A 0 0 -1000.000000 1000.000000 ECU_ADDRESS 0x0000 /* @ECU_Address@ISP_iPhaU@ */
 /begin IF_DATA XCP
  /begin DAQ_EVENT VARIABLE /begin DEFAULT_EVENT_LIST EVENT 0x0000 /end DEFAULT_EVENT_LIST /end DAQ_EVENT
 /end IF_DATA
/end MEASUREMENT
/begin MEASUREMENT ISP_iPhaV "V phase current, A" FLOAT32_IEEE CDD_ISP_CM_single_A 0 0 -1000.000000 1000.000000 ECU_ADDRESS 0x0000 /* @ECU_Address@ISP_iPhaV@ */
 /begin IF_DATA XCP
  /begin DAQ_EVENT VARIABLE /begin DEFAULT_EVENT_LIST EVENT 0x0000 /end DEFAULT_EVENT_LIST /end DAQ_EVENT
 /end IF_DATA
/end MEASUREMENT
/begin MEASUREMENT ISP_iPhaW "W phase current, A" FLOAT32_IEEE CDD_ISP_CM_single_A 0 0 -1000.000000 1000.000000 ECU_ADDRESS 0x0000 /* @ECU_Address@ISP_iPhaW@ */
 /begin IF_DATA XCP
  /begin DAQ_EVENT VARIABLE /begin DEFAULT_EVENT_LIST EVENT 0x0000 /end DEFAULT_EVENT_LIST /end DAQ_EVENT
 /end IF_DATA
/end MEASUREMENT
/begin MEASUREMENT ISP_iQaFild "q-axis filtered current,A" FLOAT32_IEEE FOC_CM_single_A 0 0 -1000.000000 1000.000000 ECU_ADDRESS 0x0000 /* @ECU_Address@ISP_iQaFild@ */
 /begin IF_DATA XCP
  /begin DAQ_EVENT VARIABLE /begin DEFAULT_EVENT_LIST EVENT 0x0000 /end DEFAULT_EVENT_LIST /end DAQ_EVENT
 /end IF_DATA
/end MEASUREMENT
/begin MEASUREMENT ISP_lossTotalIGBT "Loss of IGBT" FLOAT32_IEEE CDD_ISP_CM_single_W 0 0 0.000000 5000.000000 ECU_ADDRESS 0x0000 /* @ECU_Address@ISP_lossTotalIGBT@ */
 /begin IF_DATA XCP
  /begin DAQ_EVENT VARIABLE /begin DEFAULT_EVENT_LIST EVENT 0x0000 /end DEFAULT_EVENT_LIST /end DAQ_EVENT
 /end IF_DATA
/end MEASUREMENT
/begin MEASUREMENT ISP_n "mechanical speed" FLOAT32_IEEE CDD_ISP_CM_single_rpm 0 0 -20000.000000 20000.000000 ECU_ADDRESS 0x0000 /* @ECU_Address@ISP_n@ */
 /begin IF_DATA XCP
  /begin DAQ_EVENT VARIABLE /begin DEFAULT_EVENT_LIST EVENT 0x0000 /end DEFAULT_EVENT_LIST /end DAQ_EVENT
 /end IF_DATA
/end MEASUREMENT
/begin MEASUREMENT ISP_n_test_notch "TODO" FLOAT32_IEEE CDD_ISP_CM_single_NA 0 0 -3.4E+38 3.4E+38 ECU_ADDRESS 0x0000 /* @ECU_Address@ISP_n_test_notch@ */
 /begin IF_DATA XCP
  /begin DAQ_EVENT VARIABLE /begin DEFAULT_EVENT_LIST EVENT 0x0000 /end DEFAULT_EVENT_LIST /end DAQ_EVENT
 /end IF_DATA
/end MEASUREMENT
/begin MEASUREMENT ISP_n_test_pp "TODO" FLOAT32_IEEE CDD_ISP_CM_single_NA 0 0 -3.4E+38 3.4E+38 ECU_ADDRESS 0x0000 /* @ECU_Address@ISP_n_test_pp@ */
 /begin IF_DATA XCP
  /begin DAQ_EVENT VARIABLE /begin DEFAULT_EVENT_LIST EVENT 0x0000 /end DEFAULT_EVENT_LIST /end DAQ_EVENT
 /end IF_DATA
/end MEASUREMENT
/begin MEASUREMENT ISP_speedref_final "" FLOAT32_IEEE pmsmfoc_CM_single_NA 0 0 -3.4E+38 3.4E+38 ECU_ADDRESS 0x0000 /* @ECU_Address@ISP_speedref_final@ */
 /begin IF_DATA XCP
  /begin DAQ_EVENT VARIABLE /begin DEFAULT_EVENT_LIST EVENT 0x0000 /end DEFAULT_EVENT_LIST /end DAQ_EVENT
 /end IF_DATA
/end MEASUREMENT
/begin MEASUREMENT ISP_speedref_final_wn "TODO" FLOAT32_IEEE CDD_ISP_CM_single_NA 0 0 -3.4E+38 3.4E+38 ECU_ADDRESS 0x0000 /* @ECU_Address@ISP_speedref_final_wn@ */
 /begin IF_DATA XCP
  /begin DAQ_EVENT VARIABLE /begin DEFAULT_EVENT_LIST EVENT 0x0000 /end DEFAULT_EVENT_LIST /end DAQ_EVENT
 /end IF_DATA
/end MEASUREMENT
/begin MEASUREMENT ISP_tmpClnt "Coolant temperature" FLOAT32_IEEE CDD_ISP_CM_single_degC 0 0 -50.000000 200.000000 ECU_ADDRESS 0x0000 /* @ECU_Address@ISP_tmpClnt@ */
 /begin IF_DATA XCP
  /begin DAQ_EVENT VARIABLE /begin DEFAULT_EVENT_LIST EVENT 0x0000 /end DEFAULT_EVENT_LIST /end DAQ_EVENT
 /end IF_DATA
/end MEASUREMENT
/begin MEASUREMENT ISP_tmpMaxIGBT "Tj of IGBT" FLOAT32_IEEE CDD_ISP_CM_single_degC 0 0 -50.000000 200.000000 ECU_ADDRESS 0x0000 /* @ECU_Address@ISP_tmpMaxIGBT@ */
 /begin IF_DATA XCP
  /begin DAQ_EVENT VARIABLE /begin DEFAULT_EVENT_LIST EVENT 0x0000 /end DEFAULT_EVENT_LIST /end DAQ_EVENT
 /end IF_DATA
/end MEASUREMENT
/begin MEASUREMENT ISP_uDcFlt "Filtered DC link voltage" FLOAT32_IEEE CDD_ISP_CM_single_V 0 0 0.000000 1000.000000 ECU_ADDRESS 0x0000 /* @ECU_Address@ISP_uDcFlt@ */
 /begin IF_DATA XCP
  /begin DAQ_EVENT VARIABLE /begin DEFAULT_EVENT_LIST EVENT 0x0000 /end DEFAULT_EVENT_LIST /end DAQ_EVENT
 /end IF_DATA
/end MEASUREMENT
/begin MEASUREMENT ISP_wElec "Electric frequency of rotor" FLOAT32_IEEE CDD_ISP_CM_single_rad_per_s 0 0 -12566.000000 12566.000000 ECU_ADDRESS 0x0000 /* @ECU_Address@ISP_wElec@ */
 /begin IF_DATA XCP
  /begin DAQ_EVENT VARIABLE /begin DEFAULT_EVENT_LIST EVENT 0x0000 /end DEFAULT_EVENT_LIST /end DAQ_EVENT
 /end IF_DATA
/end MEASUREMENT
/begin MEASUREMENT PMC_FFW_opt "TODO" FLOAT32_IEEE FOC_CM_single_NA 0 0 -3.4E+38 3.4E+38 ECU_ADDRESS 0x0000 /* @ECU_Address@PMC_FFW_opt@ */
 /begin IF_DATA XCP
  /begin DAQ_EVENT VARIABLE /begin DEFAULT_EVENT_LIST EVENT 0x0000 /end DEFAULT_EVENT_LIST /end DAQ_EVENT
 /end IF_DATA
/end MEASUREMENT
/begin MEASUREMENT PMC_FWC_opt "TODO" FLOAT32_IEEE FOC_CM_single_NA 0 0 -3.4E+38 3.4E+38 ECU_ADDRESS 0x0000 /* @ECU_Address@PMC_FWC_opt@ */
 /begin IF_DATA XCP
  /begin DAQ_EVENT VARIABLE /begin DEFAULT_EVENT_LIST EVENT 0x0000 /end DEFAULT_EVENT_LIST /end DAQ_EVENT
 /end IF_DATA
/end MEASUREMENT
/begin MEASUREMENT PMC_IsMax "Caculated maximum phase current at current frequency" FLOAT32_IEEE FOC_CM_single_NA 0 0 -1000.000000 1000.000000 ECU_ADDRESS 0x0000 /* @ECU_Address@PMC_IsMax@ */
 /begin IF_DATA XCP
  /begin DAQ_EVENT VARIABLE /begin DEFAULT_EVENT_LIST EVENT 0x0000 /end DEFAULT_EVENT_LIST /end DAQ_EVENT
 /end IF_DATA
/end MEASUREMENT
/begin MEASUREMENT PMC_IsdDes "d-axis target current" FLOAT32_IEEE FOC_CM_single_A 0 0 -1000.000000 1000.000000 ECU_ADDRESS 0x0000 /* @ECU_Address@PMC_IsdDes@ */
 /begin IF_DATA XCP
  /begin DAQ_EVENT VARIABLE /begin DEFAULT_EVENT_LIST EVENT 0x0000 /end DEFAULT_EVENT_LIST /end DAQ_EVENT
 /end IF_DATA
/end MEASUREMENT
/begin MEASUREMENT PMC_IsqDes "q-axis target current" FLOAT32_IEEE FOC_CM_single_A 0 0 -1000.000000 1000.000000 ECU_ADDRESS 0x0000 /* @ECU_Address@PMC_IsqDes@ */
 /begin IF_DATA XCP
  /begin DAQ_EVENT VARIABLE /begin DEFAULT_EVENT_LIST EVENT 0x0000 /end DEFAULT_EVENT_LIST /end DAQ_EVENT
 /end IF_DATA
/end MEASUREMENT
/begin MEASUREMENT PMC_Ld "d-axis inductance" FLOAT32_IEEE FOC_CM_single_H 0 0 -0.002000 0.002000 ECU_ADDRESS 0x0000 /* @ECU_Address@PMC_Ld@ */
 /begin IF_DATA XCP
  /begin DAQ_EVENT VARIABLE /begin DEFAULT_EVENT_LIST EVENT 0x0000 /end DEFAULT_EVENT_LIST /end DAQ_EVENT
 /end IF_DATA
/end MEASUREMENT
/begin MEASUREMENT PMC_LpfOpt "TODO" FLOAT32_IEEE FOC_CM_single_NA 0 0 -3.4E+38 3.4E+38 ECU_ADDRESS 0x0000 /* @ECU_Address@PMC_LpfOpt@ */
 /begin IF_DATA XCP
  /begin DAQ_EVENT VARIABLE /begin DEFAULT_EVENT_LIST EVENT 0x0000 /end DEFAULT_EVENT_LIST /end DAQ_EVENT
 /end IF_DATA
/end MEASUREMENT
/begin MEASUREMENT PMC_LpfSpdAct "TODO" FLOAT32_IEEE FOC_CM_single_NA 0 0 -3.4E+38 3.4E+38 ECU_ADDRESS 0x0000 /* @ECU_Address@PMC_LpfSpdAct@ */
 /begin IF_DATA XCP
  /begin DAQ_EVENT VARIABLE /begin DEFAULT_EVENT_LIST EVENT 0x0000 /end DEFAULT_EVENT_LIST /end DAQ_EVENT
 /end IF_DATA
/end MEASUREMENT
/begin MEASUREMENT PMC_Lq "q-axis inductance" FLOAT32_IEEE FOC_CM_single_H 0 0 -0.002000 0.002000 ECU_ADDRESS 0x0000 /* @ECU_Address@PMC_Lq@ */
 /begin IF_DATA XCP
  /begin DAQ_EVENT VARIABLE /begin DEFAULT_EVENT_LIST EVENT 0x0000 /end DEFAULT_EVENT_LIST /end DAQ_EVENT
 /end IF_DATA
/end MEASUREMENT
/begin MEASUREMENT PMC_LqSubLd "q-axis sub d-axis inductance" FLOAT32_IEEE FOC_CM_single_H 0 0 -0.002000 0.002000 ECU_ADDRESS 0x0000 /* @ECU_Address@PMC_LqSubLd@ */
 /begin IF_DATA XCP
  /begin DAQ_EVENT VARIABLE /begin DEFAULT_EVENT_LIST EVENT 0x0000 /end DEFAULT_EVENT_LIST /end DAQ_EVENT
 /end IF_DATA
/end MEASUREMENT
/begin MEASUREMENT PMC_MTPA_opt "TODO" FLOAT32_IEEE FOC_CM_single_NA 0 0 -3.4E+38 3.4E+38 ECU_ADDRESS 0x0000 /* @ECU_Address@PMC_MTPA_opt@ */
 /begin IF_DATA XCP
  /begin DAQ_EVENT VARIABLE /begin DEFAULT_EVENT_LIST EVENT 0x0000 /end DEFAULT_EVENT_LIST /end DAQ_EVENT
 /end IF_DATA
/end MEASUREMENT
/begin MEASUREMENT PMC_PsiExc "flux" FLOAT32_IEEE FOC_CM_single_wb 0 0 -0.100000 0.100000 ECU_ADDRESS 0x0000 /* @ECU_Address@PMC_PsiExc@ */
 /begin IF_DATA XCP
  /begin DAQ_EVENT VARIABLE /begin DEFAULT_EVENT_LIST EVENT 0x0000 /end DEFAULT_EVENT_LIST /end DAQ_EVENT
 /end IF_DATA
/end MEASUREMENT
/begin MEASUREMENT PMC_PsiMax "Calculated maximum flux for flux weakening control" FLOAT32_IEEE FOC_CM_single_wb 0 0 0.000000 0.200000 ECU_ADDRESS 0x0000 /* @ECU_Address@PMC_PsiMax@ */
 /begin IF_DATA XCP
  /begin DAQ_EVENT VARIABLE /begin DEFAULT_EVENT_LIST EVENT 0x0000 /end DEFAULT_EVENT_LIST /end DAQ_EVENT
 /end IF_DATA
/end MEASUREMENT
/begin MEASUREMENT PMC_TrqOutEst "Estimated output torque" FLOAT32_IEEE FOC_CM_single_Nm 0 0 -512.000000 512.000000 ECU_ADDRESS 0x0000 /* @ECU_Address@PMC_TrqOutEst@ */
 /begin IF_DATA XCP
  /begin DAQ_EVENT VARIABLE /begin DEFAULT_EVENT_LIST EVENT 0x0001 /end DEFAULT_EVENT_LIST /end DAQ_EVENT
 /end IF_DATA
/end MEASUREMENT
/begin MEASUREMENT PMC_UsMax "SVPWM maximum phase voltage" FLOAT32_IEEE pmsmfoc_CM_single_V 0 0 0.000000 1000.000000 ECU_ADDRESS 0x0000 /* @ECU_Address@PMC_UsMax@ */
 /begin IF_DATA XCP
  /begin DAQ_EVENT VARIABLE /begin DEFAULT_EVENT_LIST EVENT 0x0000 /end DEFAULT_EVENT_LIST /end DAQ_EVENT
 /end IF_DATA
/end MEASUREMENT
/begin MEASUREMENT PMC_UsdFlt "d axis output Nrm voltage" FLOAT32_IEEE FOC_CM_single_V 0 0 -1.100000 1.100000 ECU_ADDRESS 0x0000 /* @ECU_Address@PMC_UsdFlt@ */
 /begin IF_DATA XCP
  /begin DAQ_EVENT VARIABLE /begin DEFAULT_EVENT_LIST EVENT 0x0000 /end DEFAULT_EVENT_LIST /end DAQ_EVENT
 /end IF_DATA
/end MEASUREMENT
/begin MEASUREMENT PMC_UsdScal "d axis output Nrm voltage" FLOAT32_IEEE FOC_CM_single 0 0 -1.100000 1.100000 ECU_ADDRESS 0x0000 /* @ECU_Address@PMC_UsdScal@ */
 /begin IF_DATA XCP
  /begin DAQ_EVENT VARIABLE /begin DEFAULT_EVENT_LIST EVENT 0x0000 /end DEFAULT_EVENT_LIST /end DAQ_EVENT
 /end IF_DATA
/end MEASUREMENT
/begin MEASUREMENT PMC_UsqFlt "q axis output Nrm voltage" FLOAT32_IEEE FOC_CM_single_V 0 0 -1.100000 1.100000 ECU_ADDRESS 0x0000 /* @ECU_Address@PMC_UsqFlt@ */
 /begin IF_DATA XCP
  /begin DAQ_EVENT VARIABLE /begin DEFAULT_EVENT_LIST EVENT 0x0000 /end DEFAULT_EVENT_LIST /end DAQ_EVENT
 /end IF_DATA
/end MEASUREMENT
/begin MEASUREMENT PMC_UsqScal "q axis output Nrm voltage" FLOAT32_IEEE FOC_CM_single 0 0 -1.100000 1.100000 ECU_ADDRESS 0x0000 /* @ECU_Address@PMC_UsqScal@ */
 /begin IF_DATA XCP
  /begin DAQ_EVENT VARIABLE /begin DEFAULT_EVENT_LIST EVENT 0x0000 /end DEFAULT_EVENT_LIST /end DAQ_EVENT
 /end IF_DATA
/end MEASUREMENT
/begin MEASUREMENT PMC_flgReqSafeSt "Safe state flag" UBYTE pmsmfoc_CM_boolean_NA 0 0 0.000000 1.000000 ECU_ADDRESS 0x0000 /* @ECU_Address@PMC_flgReqSafeSt@ */
 /begin IF_DATA XCP
  /begin DAQ_EVENT VARIABLE /begin DEFAULT_EVENT_LIST EVENT 0x0000 /end DEFAULT_EVENT_LIST /end DAQ_EVENT
 /end IF_DATA
/end MEASUREMENT
/begin MEASUREMENT PMC_isdFlt "" FLOAT32_IEEE FOC_CM_single_A 0 0 -1000.000000 1000.000000 ECU_ADDRESS 0x0000 /* @ECU_Address@PMC_isdFlt@ */
 /begin IF_DATA XCP
  /begin DAQ_EVENT VARIABLE /begin DEFAULT_EVENT_LIST EVENT 0x0000 /end DEFAULT_EVENT_LIST /end DAQ_EVENT
 /end IF_DATA
/end MEASUREMENT
/begin MEASUREMENT PMC_isqFlt "" FLOAT32_IEEE FOC_CM_single_A 0 0 -1000.000000 1000.000000 ECU_ADDRESS 0x0000 /* @ECU_Address@PMC_isqFlt@ */
 /begin IF_DATA XCP
  /begin DAQ_EVENT VARIABLE /begin DEFAULT_EVENT_LIST EVENT 0x0000 /end DEFAULT_EVENT_LIST /end DAQ_EVENT
 /end IF_DATA
/end MEASUREMENT
/begin MEASUREMENT PMC_pwmfrq "cmprW" FLOAT32_IEEE FOC_CM_single_NA 0 0 -3.4E+38 3.4E+38 ECU_ADDRESS 0x0000 /* @ECU_Address@PMC_pwmfrq@ */
 /begin IF_DATA XCP
  /begin DAQ_EVENT VARIABLE /begin DEFAULT_EVENT_LIST EVENT 0x0000 /end DEFAULT_EVENT_LIST /end DAQ_EVENT
 /end IF_DATA
/end MEASUREMENT
/begin MEASUREMENT PMC_stGateDrv "gate drive mode from the statemachine" SLONG pmsmfoc_CM_EGM_NA 0 0 0 4 ECU_ADDRESS 0x0000 /* @ECU_Address@PMC_stGateDrv@ */ /end MEASUREMENT
/begin MEASUREMENT PMC_tiPerd "Period time output from MCT considering variable freuqency and random frequency" FLOAT32_IEEE pmsmfoc_CM_single_NA 0 0 0.000000 1000.000000 ECU_ADDRESS 0x0000 /* @ECU_Address@PMC_tiPerd@ */
 /begin IF_DATA XCP
  /begin DAQ_EVENT VARIABLE /begin DEFAULT_EVENT_LIST EVENT 0x0000 /end DEFAULT_EVENT_LIST /end DAQ_EVENT
 /end IF_DATA
/end MEASUREMENT
/begin MEASUREMENT ToSee_idAnti_windup "TODO" FLOAT32_IEEE FOC_CM_single_NA 0 0 -3.4E+38 3.4E+38 ECU_ADDRESS 0x0000 /* @ECU_Address@ToSee_idAnti_windup@ */
 /begin IF_DATA XCP
  /begin DAQ_EVENT VARIABLE /begin DEFAULT_EVENT_LIST EVENT 0x0000 /end DEFAULT_EVENT_LIST /end DAQ_EVENT
 /end IF_DATA
/end MEASUREMENT
/begin MEASUREMENT ToSee_iqAnti_windup "TODO" FLOAT32_IEEE FOC_CM_single_NA 0 0 -3.4E+38 3.4E+38 ECU_ADDRESS 0x0000 /* @ECU_Address@ToSee_iqAnti_windup@ */
 /begin IF_DATA XCP
  /begin DAQ_EVENT VARIABLE /begin DEFAULT_EVENT_LIST EVENT 0x0000 /end DEFAULT_EVENT_LIST /end DAQ_EVENT
 /end IF_DATA
/end MEASUREMENT
/begin MEASUREMENT Trqdes_P1 "" FLOAT32_IEEE pmsmfoc_CM_single_NA 0 0 -3.4E+38 3.4E+38 ECU_ADDRESS 0x0000 /* @ECU_Address@Trqdes_P1@ */
 /begin IF_DATA XCP
  /begin DAQ_EVENT VARIABLE /begin DEFAULT_EVENT_LIST EVENT 0x0000 /end DEFAULT_EVENT_LIST /end DAQ_EVENT
 /end IF_DATA
/end MEASUREMENT
/begin MEASUREMENT Uq_output_limit "TODO" FLOAT32_IEEE FOC_CM_single_NA 0 0 -3.4E+38 3.4E+38 ECU_ADDRESS 0x0000 /* @ECU_Address@Uq_output_limit@ */
 /begin IF_DATA XCP
  /begin DAQ_EVENT VARIABLE /begin DEFAULT_EVENT_LIST EVENT 0x0000 /end DEFAULT_EVENT_LIST /end DAQ_EVENT
 /end IF_DATA
/end MEASUREMENT
/begin MEASUREMENT X111 "TODO" FLOAT32_IEEE CDD_ISP_CM_single_NA 0 0 -3.4E+38 3.4E+38 ECU_ADDRESS 0x0000 /* @ECU_Address@X111@ */
 /begin IF_DATA XCP
  /begin DAQ_EVENT VARIABLE /begin DEFAULT_EVENT_LIST EVENT 0x0000 /end DEFAULT_EVENT_LIST /end DAQ_EVENT
 /end IF_DATA
/end MEASUREMENT
/begin MEASUREMENT X222 "TODO" FLOAT32_IEEE CDD_ISP_CM_single_NA 0 0 -3.4E+38 3.4E+38 ECU_ADDRESS 0x0000 /* @ECU_Address@X222@ */
 /begin IF_DATA XCP
  /begin DAQ_EVENT VARIABLE /begin DEFAULT_EVENT_LIST EVENT 0x0000 /end DEFAULT_EVENT_LIST /end DAQ_EVENT
 /end IF_DATA
/end MEASUREMENT
/begin MEASUREMENT Y111 "TODO" FLOAT32_IEEE CDD_ISP_CM_single_NA 0 0 -3.4E+38 3.4E+38 ECU_ADDRESS 0x0000 /* @ECU_Address@Y111@ */
 /begin IF_DATA XCP
  /begin DAQ_EVENT VARIABLE /begin DEFAULT_EVENT_LIST EVENT 0x0000 /end DEFAULT_EVENT_LIST /end DAQ_EVENT
 /end IF_DATA
/end MEASUREMENT
/begin MEASUREMENT Y222 "TODO" FLOAT32_IEEE CDD_ISP_CM_single_NA 0 0 -3.4E+38 3.4E+38 ECU_ADDRESS 0x0000 /* @ECU_Address@Y222@ */
 /begin IF_DATA XCP
  /begin DAQ_EVENT VARIABLE /begin DEFAULT_EVENT_LIST EVENT 0x0000 /end DEFAULT_EVENT_LIST /end DAQ_EVENT
 /end IF_DATA
/end MEASUREMENT
/begin MEASUREMENT a1 "TODO" FLOAT32_IEEE CDD_ISP_CM_single_NA 0 0 -3.4E+38 3.4E+38 ECU_ADDRESS 0x0000 /* @ECU_Address@a1@ */
 /begin IF_DATA XCP
  /begin DAQ_EVENT VARIABLE /begin DEFAULT_EVENT_LIST EVENT 0x0000 /end DEFAULT_EVENT_LIST /end DAQ_EVENT
 /end IF_DATA
/end MEASUREMENT
/begin MEASUREMENT a2 "TODO" FLOAT32_IEEE CDD_ISP_CM_single_NA 0 0 -3.4E+38 3.4E+38 ECU_ADDRESS 0x0000 /* @ECU_Address@a2@ */
 /begin IF_DATA XCP
  /begin DAQ_EVENT VARIABLE /begin DEFAULT_EVENT_LIST EVENT 0x0000 /end DEFAULT_EVENT_LIST /end DAQ_EVENT
 /end IF_DATA
/end MEASUREMENT
/begin MEASUREMENT a3 "TODO" FLOAT32_IEEE CDD_ISP_CM_single_NA 0 0 -3.4E+38 3.4E+38 ECU_ADDRESS 0x0000 /* @ECU_Address@a3@ */
 /begin IF_DATA XCP
  /begin DAQ_EVENT VARIABLE /begin DEFAULT_EVENT_LIST EVENT 0x0000 /end DEFAULT_EVENT_LIST /end DAQ_EVENT
 /end IF_DATA
/end MEASUREMENT
/begin MEASUREMENT b1 "TODO" FLOAT32_IEEE CDD_ISP_CM_single_NA 0 0 -3.4E+38 3.4E+38 ECU_ADDRESS 0x0000 /* @ECU_Address@b1@ */
 /begin IF_DATA XCP
  /begin DAQ_EVENT VARIABLE /begin DEFAULT_EVENT_LIST EVENT 0x0000 /end DEFAULT_EVENT_LIST /end DAQ_EVENT
 /end IF_DATA
/end MEASUREMENT
/begin MEASUREMENT b2 "TODO" FLOAT32_IEEE CDD_ISP_CM_single_NA 0 0 -3.4E+38 3.4E+38 ECU_ADDRESS 0x0000 /* @ECU_Address@b2@ */
 /begin IF_DATA XCP
  /begin DAQ_EVENT VARIABLE /begin DEFAULT_EVENT_LIST EVENT 0x0000 /end DEFAULT_EVENT_LIST /end DAQ_EVENT
 /end IF_DATA
/end MEASUREMENT
/begin MEASUREMENT b3 "TODO" FLOAT32_IEEE CDD_ISP_CM_single_NA 0 0 -3.4E+38 3.4E+38 ECU_ADDRESS 0x0000 /* @ECU_Address@b3@ */
 /begin IF_DATA XCP
  /begin DAQ_EVENT VARIABLE /begin DEFAULT_EVENT_LIST EVENT 0x0000 /end DEFAULT_EVENT_LIST /end DAQ_EVENT
 /end IF_DATA
/end MEASUREMENT
/begin MEASUREMENT cmprU "cmprU" FLOAT32_IEEE FOC_CM_single 0 0 -3.4E+38 3.4E+38 ECU_ADDRESS 0x0000 /* @ECU_Address@cmprU@ */
 /begin IF_DATA XCP
  /begin DAQ_EVENT VARIABLE /begin DEFAULT_EVENT_LIST EVENT 0x0000 /end DEFAULT_EVENT_LIST /end DAQ_EVENT
 /end IF_DATA
/end MEASUREMENT
/begin MEASUREMENT cmprV "cmprV" FLOAT32_IEEE FOC_CM_single 0 0 -3.4E+38 3.4E+38 ECU_ADDRESS 0x0000 /* @ECU_Address@cmprV@ */
 /begin IF_DATA XCP
  /begin DAQ_EVENT VARIABLE /begin DEFAULT_EVENT_LIST EVENT 0x0000 /end DEFAULT_EVENT_LIST /end DAQ_EVENT
 /end IF_DATA
/end MEASUREMENT
/begin MEASUREMENT cmprW "cmprW" FLOAT32_IEEE FOC_CM_single 0 0 -3.4E+38 3.4E+38 ECU_ADDRESS 0x0000 /* @ECU_Address@cmprW@ */
 /begin IF_DATA XCP
  /begin DAQ_EVENT VARIABLE /begin DEFAULT_EVENT_LIST EVENT 0x0000 /end DEFAULT_EVENT_LIST /end DAQ_EVENT
 /end IF_DATA
/end MEASUREMENT
/begin MEASUREMENT d_decouple "TODO" FLOAT32_IEEE FOC_CM_single_NA 0 0 -3.4E+38 3.4E+38 ECU_ADDRESS 0x0000 /* @ECU_Address@d_decouple@ */
 /begin IF_DATA XCP
  /begin DAQ_EVENT VARIABLE /begin DEFAULT_EVENT_LIST EVENT 0x0000 /end DEFAULT_EVENT_LIST /end DAQ_EVENT
 /end IF_DATA
/end MEASUREMENT
/begin MEASUREMENT d_integral "TODO" FLOAT32_IEEE FOC_CM_single_NA 0 0 -3.4E+38 3.4E+38 ECU_ADDRESS 0x0000 /* @ECU_Address@d_integral@ */
 /begin IF_DATA XCP
  /begin DAQ_EVENT VARIABLE /begin DEFAULT_EVENT_LIST EVENT 0x0000 /end DEFAULT_EVENT_LIST /end DAQ_EVENT
 /end IF_DATA
/end MEASUREMENT
/begin MEASUREMENT k1 "TODO" FLOAT32_IEEE CDD_ISP_CM_single_NA 0 0 -3.4E+38 3.4E+38 ECU_ADDRESS 0x0000 /* @ECU_Address@k1@ */
 /begin IF_DATA XCP
  /begin DAQ_EVENT VARIABLE /begin DEFAULT_EVENT_LIST EVENT 0x0000 /end DEFAULT_EVENT_LIST /end DAQ_EVENT
 /end IF_DATA
/end MEASUREMENT
/begin MEASUREMENT k2 "TODO" FLOAT32_IEEE CDD_ISP_CM_single_NA 0 0 -3.4E+38 3.4E+38 ECU_ADDRESS 0x0000 /* @ECU_Address@k2@ */
 /begin IF_DATA XCP
  /begin DAQ_EVENT VARIABLE /begin DEFAULT_EVENT_LIST EVENT 0x0000 /end DEFAULT_EVENT_LIST /end DAQ_EVENT
 /end IF_DATA
/end MEASUREMENT
/begin MEASUREMENT omega_hat_K_1 "TODO" FLOAT32_IEEE CDD_ISP_CM_single_NA 0 0 -3.4E+38 3.4E+38 ECU_ADDRESS 0x0000 /* @ECU_Address@omega_hat_K_1@ */
 /begin IF_DATA XCP
  /begin DAQ_EVENT VARIABLE /begin DEFAULT_EVENT_LIST EVENT 0x0000 /end DEFAULT_EVENT_LIST /end DAQ_EVENT
 /end IF_DATA
/end MEASUREMENT
/begin MEASUREMENT q_decouple_Add_ffw "TODO" FLOAT32_IEEE FOC_CM_single_NA 0 0 -3.4E+38 3.4E+38 ECU_ADDRESS 0x0000 /* @ECU_Address@q_decouple_Add_ffw@ */
 /begin IF_DATA XCP
  /begin DAQ_EVENT VARIABLE /begin DEFAULT_EVENT_LIST EVENT 0x0000 /end DEFAULT_EVENT_LIST /end DAQ_EVENT
 /end IF_DATA
/end MEASUREMENT
/begin MEASUREMENT q_integral "TODO" FLOAT32_IEEE FOC_CM_single_NA 0 0 -3.4E+38 3.4E+38 ECU_ADDRESS 0x0000 /* @ECU_Address@q_integral@ */
 /begin IF_DATA XCP
  /begin DAQ_EVENT VARIABLE /begin DEFAULT_EVENT_LIST EVENT 0x0000 /end DEFAULT_EVENT_LIST /end DAQ_EVENT
 /end IF_DATA
/end MEASUREMENT
/begin MEASUREMENT q_volt_lower "TODO" FLOAT32_IEEE FOC_CM_single_NA 0 0 -3.4E+38 3.4E+38 ECU_ADDRESS 0x0000 /* @ECU_Address@q_volt_lower@ */
 /begin IF_DATA XCP
  /begin DAQ_EVENT VARIABLE /begin DEFAULT_EVENT_LIST EVENT 0x0000 /end DEFAULT_EVENT_LIST /end DAQ_EVENT
 /end IF_DATA
/end MEASUREMENT
/begin MEASUREMENT q_volt_upper "TODO" FLOAT32_IEEE FOC_CM_single_NA 0 0 -3.4E+38 3.4E+38 ECU_ADDRESS 0x0000 /* @ECU_Address@q_volt_upper@ */
 /begin IF_DATA XCP
  /begin DAQ_EVENT VARIABLE /begin DEFAULT_EVENT_LIST EVENT 0x0000 /end DEFAULT_EVENT_LIST /end DAQ_EVENT
 /end IF_DATA
/end MEASUREMENT
/begin MEASUREMENT temp1_111 "TODO" FLOAT32_IEEE CDD_ISP_CM_single_NA 0 0 -3.4E+38 3.4E+38 ECU_ADDRESS 0x0000 /* @ECU_Address@temp1_111@ */
 /begin IF_DATA XCP
  /begin DAQ_EVENT VARIABLE /begin DEFAULT_EVENT_LIST EVENT 0x0000 /end DEFAULT_EVENT_LIST /end DAQ_EVENT
 /end IF_DATA
/end MEASUREMENT
/begin MEASUREMENT temp2_222 "TODO" FLOAT32_IEEE CDD_ISP_CM_single_NA 0 0 -3.4E+38 3.4E+38 ECU_ADDRESS 0x0000 /* @ECU_Address@temp2_222@ */
 /begin IF_DATA XCP
  /begin DAQ_EVENT VARIABLE /begin DEFAULT_EVENT_LIST EVENT 0x0000 /end DEFAULT_EVENT_LIST /end DAQ_EVENT
 /end IF_DATA
/end MEASUREMENT
/begin MEASUREMENT test2 "TODO" FLOAT32_IEEE CDD_ISP_CM_single_NA 0 0 -3.4E+38 3.4E+38 ECU_ADDRESS 0x0000 /* @ECU_Address@test2@ */
 /begin IF_DATA XCP
  /begin DAQ_EVENT VARIABLE /begin DEFAULT_EVENT_LIST EVENT 0x0000 /end DEFAULT_EVENT_LIST /end DAQ_EVENT
 /end IF_DATA
/end MEASUREMENT
/begin MEASUREMENT test8 "TODO" FLOAT32_IEEE CDD_ISP_CM_single_NA 0 0 -3.4E+38 3.4E+38 ECU_ADDRESS 0x0000 /* @ECU_Address@test8@ */
 /begin IF_DATA XCP
  /begin DAQ_EVENT VARIABLE /begin DEFAULT_EVENT_LIST EVENT 0x0000 /end DEFAULT_EVENT_LIST /end DAQ_EVENT
 /end IF_DATA
/end MEASUREMENT
/begin MEASUREMENT theta_hat_K_1 "TODO" FLOAT32_IEEE CDD_ISP_CM_single_NA 0 0 -3.4E+38 3.4E+38 ECU_ADDRESS 0x0000 /* @ECU_Address@theta_hat_K_1@ */
 /begin IF_DATA XCP
  /begin DAQ_EVENT VARIABLE /begin DEFAULT_EVENT_LIST EVENT 0x0000 /end DEFAULT_EVENT_LIST /end DAQ_EVENT
 /end IF_DATA
/end MEASUREMENT
/begin MEASUREMENT usage "cmprW" FLOAT32_IEEE FOC_CM_single_NA 0 0 -3.4E+38 3.4E+38 ECU_ADDRESS 0x0000 /* @ECU_Address@usage@ */
 /begin IF_DATA XCP
  /begin DAQ_EVENT VARIABLE /begin DEFAULT_EVENT_LIST EVENT 0x0000 /end DEFAULT_EVENT_LIST /end DAQ_EVENT
 /end IF_DATA
/end MEASUREMENT
/begin MEASUREMENT usd_output "TODO" FLOAT32_IEEE FOC_CM_single_NA 0 0 -3.4E+38 3.4E+38 ECU_ADDRESS 0x0000 /* @ECU_Address@usd_output@ */
 /begin IF_DATA XCP
  /begin DAQ_EVENT VARIABLE /begin DEFAULT_EVENT_LIST EVENT 0x0000 /end DEFAULT_EVENT_LIST /end DAQ_EVENT
 /end IF_DATA
/end MEASUREMENT
/begin MEASUREMENT usq_output "TODO" FLOAT32_IEEE FOC_CM_single_NA 0 0 -3.4E+38 3.4E+38 ECU_ADDRESS 0x0000 /* @ECU_Address@usq_output@ */
 /begin IF_DATA XCP
  /begin DAQ_EVENT VARIABLE /begin DEFAULT_EVENT_LIST EVENT 0x0000 /end DEFAULT_EVENT_LIST /end DAQ_EVENT
 /end IF_DATA
/end MEASUREMENT
/begin COMPU_METHOD CDD_ISP_CM_int16_NA "Q = V" RAT_FUNC "%5.0" "NA" COEFFS 0 1 0 0 0 1 /end COMPU_METHOD
/begin COMPU_METHOD CDD_ISP_CM_single_A "Q = V" RAT_FUNC "%8.6" "A" COEFFS 0 1 0 0 0 1 /end COMPU_METHOD
/begin COMPU_METHOD CDD_ISP_CM_single_Hz "Q = V" RAT_FUNC "%8.6" "Hz" COEFFS 0 1 0 0 0 1 /end COMPU_METHOD
/begin COMPU_METHOD CDD_ISP_CM_single_NA "Q = V" RAT_FUNC "%8.6" "NA" COEFFS 0 1 0 0 0 1 /end COMPU_METHOD
/begin COMPU_METHOD CDD_ISP_CM_single_V "Q = V" RAT_FUNC "%8.6" "V" COEFFS 0 1 0 0 0 1 /end COMPU_METHOD
/begin COMPU_METHOD CDD_ISP_CM_single_W "Q = V" RAT_FUNC "%8.6" "W" COEFFS 0 1 0 0 0 1 /end COMPU_METHOD
/begin COMPU_METHOD CDD_ISP_CM_single_degC "Q = V" RAT_FUNC "%8.6" "degC" COEFFS 0 1 0 0 0 1 /end COMPU_METHOD
/begin COMPU_METHOD CDD_ISP_CM_single_rad_per_s "Q = V" RAT_FUNC "%8.6" "rad/s" COEFFS 0 1 0 0 0 1 /end COMPU_METHOD
/begin COMPU_METHOD CDD_ISP_CM_single_rpm "Q = V" RAT_FUNC "%8.6" "rpm" COEFFS 0 1 0 0 0 1 /end COMPU_METHOD
/begin COMPU_METHOD CDD_ISP_CM_single_s "Q = V" RAT_FUNC "%8.6" "s" COEFFS 0 1 0 0 0 1 /end COMPU_METHOD
/begin COMPU_METHOD CDD_ISP_CM_uint16_NA "Q = V" RAT_FUNC "%5.0" "NA" COEFFS 0 1 0 0 0 1 /end COMPU_METHOD
/begin COMPU_METHOD FOC_CM_logical_NA "Q = V" RAT_FUNC "%1.0" "NA" COEFFS 0 1 0 0 0 1 /end COMPU_METHOD
/begin COMPU_METHOD FOC_CM_single "Q = V" RAT_FUNC "%8.6" "" COEFFS 0 1 0 0 0 1 /end COMPU_METHOD
/begin COMPU_METHOD FOC_CM_single_A "Q = V" RAT_FUNC "%8.6" "A" COEFFS 0 1 0 0 0 1 /end COMPU_METHOD
/begin COMPU_METHOD FOC_CM_single_H "Q = V" RAT_FUNC "%8.6" "H" COEFFS 0 1 0 0 0 1 /end COMPU_METHOD
/begin COMPU_METHOD FOC_CM_single_NA "Q = V" RAT_FUNC "%8.6" "NA" COEFFS 0 1 0 0 0 1 /end COMPU_METHOD
/begin COMPU_METHOD FOC_CM_single_Nm "Q = V" RAT_FUNC "%8.6" "Nm" COEFFS 0 1 0 0 0 1 /end COMPU_METHOD
/begin COMPU_METHOD FOC_CM_single_V "Q = V" RAT_FUNC "%8.6" "V" COEFFS 0 1 0 0 0 1 /end COMPU_METHOD
/begin COMPU_METHOD FOC_CM_single_degC "Q = V" RAT_FUNC "%8.6" "degC" COEFFS 0 1 0 0 0 1 /end COMPU_METHOD
/begin COMPU_METHOD FOC_CM_single_wb "Q = V" RAT_FUNC "%8.6" "wb" COEFFS 0 1 0 0 0 1 /end COMPU_METHOD
/begin COMPU_METHOD pmsmfoc_CM_EGM_NA "Enumerated data type: EGM" TAB_VERB "%0.6" "NA" /* Conversion Table */ COMPU_TAB_REF VTAB_FOR_pmsmfoc_CM_EGM_NA /end COMPU_METHOD
/begin COMPU_VTAB /* Name of Table */ VTAB_FOR_pmsmfoc_CM_EGM_NA "Enumerated data type: EGM" TAB_VERB /* Number of Elements */ 5 0 "Freewheel" 1 "Shortcircuit" 2 "ShortcircuitTop" 3 "PWMRun" 4 "PWMDischarge" /end COMPU_VTAB
/begin COMPU_METHOD pmsmfoc_CM_boolean_NA "Q = V" RAT_FUNC "%1.0" "NA" COEFFS 0 1 0 0 0 1 /end COMPU_METHOD
/begin COMPU_METHOD pmsmfoc_CM_int16_NA "Q = V" RAT_FUNC "%5.0" "NA" COEFFS 0 1 0 0 0 1 /end COMPU_METHOD
/begin COMPU_METHOD pmsmfoc_CM_single_A "Q = V" RAT_FUNC "%8.6" "A" COEFFS 0 1 0 0 0 1 /end COMPU_METHOD
/begin COMPU_METHOD pmsmfoc_CM_single_NA "Q = V" RAT_FUNC "%8.6" "NA" COEFFS 0 1 0 0 0 1 /end COMPU_METHOD
/begin COMPU_METHOD pmsmfoc_CM_single_Nm "Q = V" RAT_FUNC "%8.6" "Nm" COEFFS 0 1 0 0 0 1 /end COMPU_METHOD
/begin COMPU_METHOD pmsmfoc_CM_single_V "Q = V" RAT_FUNC "%8.6" "V" COEFFS 0 1 0 0 0 1 /end COMPU_METHOD
/begin COMPU_METHOD pmsmfoc_CM_single_rpm "Q = V" RAT_FUNC "%8.6" "rpm" COEFFS 0 1 0 0 0 1 /end COMPU_METHOD
/begin RECORD_LAYOUT Record_BOOLEAN FNC_VALUES 1 UBYTE COLUMN_DIR DIRECT /end RECORD_LAYOUT
/begin RECORD_LAYOUT Record_FLOAT32_IEEE FNC_VALUES 1 FLOAT32_IEEE COLUMN_DIR DIRECT /end RECORD_LAYOUT
/begin RECORD_LAYOUT Record_SLONG FNC_VALUES 1 SLONG COLUMN_DIR DIRECT /end RECORD_LAYOUT
/begin RECORD_LAYOUT Record_SWORD FNC_VALUES 1 SWORD COLUMN_DIR DIRECT /end RECORD_LAYOUT
/begin RECORD_LAYOUT Record_UWORD FNC_VALUES 1 UWORD COLUMN_DIR DIRECT /end RECORD_LAYOUT
/* Record Layouts for Lookup Tables in Standard Axis format */
/begin RECORD_LAYOUT ExFeedBackST AXIS_PTS_X 2 FLOAT32_IEEE INDEX_INCR DIRECT AXIS_PTS_Y 1 FLOAT32_IEEE INDEX_INCR DIRECT FNC_VALUES 3 FLOAT32_IEEE COLUMN_DIR DIRECT /end RECORD_LAYOUT
/begin RECORD_LAYOUT MTPAST AXIS_PTS_X 2 FLOAT32_IEEE INDEX_INCR DIRECT AXIS_PTS_Y 1 FLOAT32_IEEE INDEX_INCR DIRECT FNC_VALUES 3 FLOAT32_IEEE COLUMN_DIR DIRECT /end RECORD_LAYOUT
/begin RECORD_LAYOUT cLdAdptMonST AXIS_PTS_X 2 FLOAT32_IEEE INDEX_INCR DIRECT AXIS_PTS_Y 1 FLOAT32_IEEE INDEX_INCR DIRECT FNC_VALUES 3 FLOAT32_IEEE COLUMN_DIR DIRECT /end RECORD_LAYOUT
/begin RECORD_LAYOUT cLqAdptMonST AXIS_PTS_X 2 FLOAT32_IEEE INDEX_INCR DIRECT AXIS_PTS_Y 1 FLOAT32_IEEE INDEX_INCR DIRECT FNC_VALUES 3 FLOAT32_IEEE COLUMN_DIR DIRECT /end RECORD_LAYOUT
/begin RECORD_LAYOUT cPsiIsqAdptMotSTT AXIS_PTS_X 1 FLOAT32_IEEE INDEX_INCR DIRECT FNC_VALUES 2 FLOAT32_IEEE COLUMN_DIR DIRECT /end RECORD_LAYOUT
/begin GROUP pmsmfoc "pmsmfoc" /* Root */ ROOT /begin SUB_GROUP pmsmfoc_CoreMsgIf pmsmfoc_PMC_SVM /end SUB_GROUP
 /begin REF_CHARACTERISTIC IdROL_C SC_pRsv_P SC_p_P agNegTrans_C f32_SpeedFltCoef facAdc2iPh_C facAdc2uDclnk_C g_msgCore0to2_L1 g_msgCore0to2_L2 g_msgCore0to2_N111 g_msgCore0to2_N222 g_msgCore0to2_depth g_msgCore0to2_detlaAngle_single g_msgCore0to2_fbw g_msgCore0to2_wb iPhaMax_C iPhaMin_C offsAgRtrElec_C rotatedirection_C tauUdcPT1_C uDcMax_C uDcMin_C /end REF_CHARACTERISTIC
 /begin REF_MEASUREMENT ISP_agRtrElecAtan2 ISP_n ISP_speedref_final Trqdes_P1 /end REF_MEASUREMENT
/end GROUP
/begin GROUP pmsmfoc_293_FOC_Model "pmsmfoc/PMC&SVM/Model" /begin SUB_GROUP pmsmfoc_293_FOC_Model_bldc /end SUB_GROUP /end GROUP
/begin GROUP pmsmfoc_293_FOC_Model_bldc "FOC/bldc"
 /begin SUB_GROUP pmsmfoc_293_FOC_Model_bldc_AngleComp pmsmfoc_293_FOC_Model_bldc_FwcFdbCalc pmsmfoc_293_FOC_Model_bldc_PMC_IsDesCalc pmsmfoc_293_FOC_Model_bldc_PMC_PsmMdl1 pmsmfoc_293_FOC_Model_bldc_PT1 pmsmfoc_293_FOC_Model_bldc_PT2 pmsmfoc_293_FOC_Model_bldc_PT3 pmsmfoc_293_FOC_Model_bldc_PWMfreq pmsmfoc_293_FOC_Model_bldc_Subsystem pmsmfoc_293_FOC_Model_bldc_Subsystem1 pmsmfoc_293_FOC_Model_bldc_Subsystem3 pmsmfoc_293_FOC_Model_bldc_Subsystem4 pmsmfoc_293_FOC_Model_bldc_abc2dq /end SUB_GROUP
 /begin REF_CHARACTERISTIC FFW_enable f32_P_Coef f32_P_Modulation g_msgCore0to2_DecoupleEn g_msgCore0to2_arc_dd_fi g_msgCore0to2_clpwitch g_msgCore0to2_dqLpf g_msgCore0to2_dqLpfSpdCoef g_msgCore0to2_motorseq g_msgCore0to2_spdswitch u16_P_MotorPair /end REF_CHARACTERISTIC
 /begin REF_MEASUREMENT PMC_IsdDes PMC_IsqDes PMC_Ld PMC_LpfOpt PMC_LpfSpdAct PMC_Lq PMC_PsiExc PMC_UsdScal PMC_UsqScal PMC_isdFlt PMC_isqFlt ToSee_idAnti_windup ToSee_iqAnti_windup Uq_output_limit d_decouple d_integral q_decouple_Add_ffw q_integral q_volt_lower q_volt_upper usd_output usq_output /end REF_MEASUREMENT
/end GROUP
/begin GROUP pmsmfoc_293_FOC_Model_bldc_AngleComp "FOC/bldc/AngleComp" /begin REF_CHARACTERISTIC f32_P_AngleCompCur f32_P_AngleCompVol /end REF_CHARACTERISTIC /begin REF_MEASUREMENT PMC_pwmfrq /end REF_MEASUREMENT /end GROUP
/begin GROUP pmsmfoc_293_FOC_Model_bldc_FwcFdbCalc "FOC/bldc/FwcFdbCalc" /begin SUB_GROUP pmsmfoc_293_FOC_Model_bldc_FwcFdbCalc_PT1_1 /end SUB_GROUP /end GROUP
/begin GROUP pmsmfoc_293_FOC_Model_bldc_FwcFdbCalc_PT1_1 "FOC/bldc/FwcFdbCalc/PT1_1" /begin REF_MEASUREMENT usage /end REF_MEASUREMENT /end GROUP
/begin GROUP pmsmfoc_293_FOC_Model_bldc_PMC_IsDesCalc "FOC/bldc/PMC_IsDesCalc"
 /begin SUB_GROUP pmsmfoc_293_FOC_Model_bldc_PMC_IsDesCalc_FWC pmsmfoc_293_FOC_Model_bldc_PMC_IsDesCalc_MaxI_vs_Freq pmsmfoc_293_FOC_Model_bldc_PMC_IsDesCalc_PMC_IsdDesCalc pmsmfoc_293_FOC_Model_bldc_PMC_IsDesCalc_PMC_IsqDesCalc /end SUB_GROUP
 /begin REF_CHARACTERISTIC f32_P_Modulation u16_P_MotorPair /end REF_CHARACTERISTIC
 /begin REF_MEASUREMENT PMC_IsqDes Trqdes_P1 o_o_o_f32_Duty_f32_DutyWon /end REF_MEASUREMENT
/end GROUP
/begin GROUP pmsmfoc_293_FOC_Model_bldc_PMC_IsDesCalc_FWC "FOC/bldc/PMC_IsDesCalc/FWC" /begin SUB_GROUP pmsmfoc_293_FOC_Model_bldc_PMC_IsDesCalc_FWC_PI /end SUB_GROUP /begin REF_MEASUREMENT PMC_FWC_opt PMC_MTPA_opt usage /end REF_MEASUREMENT /end GROUP
/begin GROUP pmsmfoc_293_FOC_Model_bldc_PMC_IsDesCalc_FWC_PI "FOC/bldc/PMC_IsDesCalc/FWC/PI"
 /begin REF_CHARACTERISTIC g_msgCore0to2_AfrKp g_msgCore0to2_AfrTi g_msgCore0to2_maxCur /end REF_CHARACTERISTIC
/end GROUP
/begin GROUP pmsmfoc_293_FOC_Model_bldc_PMC_IsDesCalc_MaxI_vs_Freq "FOC/bldc/PMC_IsDesCalc/MaxI vs Freq" /begin REF_CHARACTERISTIC g_msgCore0to2_maxCur /end REF_CHARACTERISTIC /begin REF_MEASUREMENT PMC_IsMax /end REF_MEASUREMENT /end GROUP
/begin GROUP pmsmfoc_293_FOC_Model_bldc_PMC_IsDesCalc_PMC_IsdDesCalc "FOC/bldc/PMC_IsDesCalc/PMC_IsdDesCalc"
 /begin SUB_GROUP pmsmfoc_293_FOC_Model_bldc_PMC_IsDesCalc_PMC_IsdDesCalc_iDaDesTblLimd /end SUB_GROUP
/end GROUP
/begin GROUP pmsmfoc_293_FOC_Model_bldc_PMC_IsDesCalc_PMC_IsdDesCalc_iDaDesTblLimd "FOC/bldc/PMC_IsDesCalc/PMC_IsdDesCalc/iDaDesTblLimd"
 /begin REF_CHARACTERISTIC ExFeedBack_T MTPA_T g_msgCore0to2_CalibEn g_msgCore0to2_FFW_Gain g_msgCore0to2_MTPA_Gain g_msgCore0to2_maxCur g_msgCore0to2_maxFwcCurRatio /end REF_CHARACTERISTIC
 /begin REF_MEASUREMENT PMC_FFW_opt PMC_MTPA_opt PMC_PsiMax Trqdes_P1 /end REF_MEASUREMENT
/end GROUP
/begin GROUP pmsmfoc_293_FOC_Model_bldc_PMC_IsDesCalc_PMC_IsqDesCalc "FOC/bldc/PMC_IsDesCalc/PMC_IsqDesCalc"
 /begin SUB_GROUP pmsmfoc_293_FOC_Model_bldc_PMC_IsDesCalc_PMC_IsqDesCalc_IsqDesLim_Calc pmsmfoc_293_FOC_Model_bldc_PMC_IsDesCalc_PMC_IsqDesCalc_IsqTrqDes_Calc /end SUB_GROUP
/end GROUP
/begin GROUP pmsmfoc_293_FOC_Model_bldc_PMC_IsDesCalc_PMC_IsqDesCalc_IsqDesLim_Calc "FOC/bldc/PMC_IsDesCalc/PMC_IsqDesCalc/IsqDesLim_Calc"
 /begin SUB_GROUP pmsmfoc_293_FOC_Model_bldc_PMC_IsDesCalc_PMC_IsqDesCalc_IsqDesLim_Calc_SQRT /end SUB_GROUP
 /begin REF_MEASUREMENT PMC_IsMax /end REF_MEASUREMENT
/end GROUP
/begin GROUP pmsmfoc_293_FOC_Model_bldc_PMC_IsDesCalc_PMC_IsqDesCalc_IsqDesLim_Calc_SQRT "FOC/bldc/PMC_IsDesCalc/PMC_IsqDesCalc/IsqDesLim_Calc/SQRT" /begin REF_MEASUREMENT o_o_o_f32_Duty_f32_DutyUon /end REF_MEASUREMENT /end GROUP
/begin GROUP pmsmfoc_293_FOC_Model_bldc_PMC_IsDesCalc_PMC_IsqDesCalc_IsqTrqDes_Calc "FOC/bldc/PMC_IsDesCalc/PMC_IsqDesCalc/IsqTrqDes_Calc"
 /begin SUB_GROUP pmsmfoc_293_FOC_Model_bldc_PMC_IsDesCalc_PMC_IsqDesCalc_IsqTrqDes_Calc_MCT_PsmPsiTrqCalc /end SUB_GROUP
 /begin REF_CHARACTERISTIC g_msgCore0to2_CalibEn /end REF_CHARACTERISTIC
 /begin REF_MEASUREMENT Trqdes_P1 /end REF_MEASUREMENT
/end GROUP
/begin GROUP pmsmfoc_293_FOC_Model_bldc_PMC_IsDesCalc_PMC_IsqDesCalc_IsqTrqDes_Calc_MCT_PsmPsiTrqCalc "FOC/bldc/PMC_IsDesCalc/PMC_IsqDesCalc/IsqTrqDes_Calc/MCT_PsmPsiTrqCalc" /begin REF_CHARACTERISTIC u16_P_MotorPair /end REF_CHARACTERISTIC /begin REF_MEASUREMENT PMC_LqSubLd /end REF_MEASUREMENT /end GROUP
/begin GROUP pmsmfoc_293_FOC_Model_bldc_PMC_PsmMdl1 "FOC/bldc/PMC_PsmMdl1"
 /begin SUB_GROUP pmsmfoc_293_FOC_Model_bldc_PMC_PsmMdl1_MCT_GenSigCalcn pmsmfoc_293_FOC_Model_bldc_PMC_PsmMdl1_MCT_PsmParCalc pmsmfoc_293_FOC_Model_bldc_PMC_PsmMdl1_PMC_TrqCal /end SUB_GROUP
 /begin REF_CHARACTERISTIC SC_Psi_P /end REF_CHARACTERISTIC
 /begin REF_MEASUREMENT ISP_iDaFild ISP_iQaFild PMC_LqSubLd PMC_PsiExc PMC_isdFlt PMC_isqFlt /end REF_MEASUREMENT
/end GROUP
/begin GROUP pmsmfoc_293_FOC_Model_bldc_PMC_PsmMdl1_MCT_GenSigCalcn "FOC/bldc/PMC_PsmMdl1/MCT_GenSigCalcn"
 /begin SUB_GROUP pmsmfoc_293_FOC_Model_bldc_PMC_PsmMdl1_MCT_GenSigCalcn_PT1 pmsmfoc_293_FOC_Model_bldc_PMC_PsmMdl1_MCT_GenSigCalcn_PT2 /end SUB_GROUP
/end GROUP
/begin GROUP pmsmfoc_293_FOC_Model_bldc_PMC_PsmMdl1_MCT_GenSigCalcn_PT1 "FOC/bldc/PMC_PsmMdl1/MCT_GenSigCalcn/PT1" /begin REF_MEASUREMENT ISP_iDaFild /end REF_MEASUREMENT /end GROUP
/begin GROUP pmsmfoc_293_FOC_Model_bldc_PMC_PsmMdl1_MCT_GenSigCalcn_PT2 "FOC/bldc/PMC_PsmMdl1/MCT_GenSigCalcn/PT2" /begin REF_MEASUREMENT ISP_iQaFild /end REF_MEASUREMENT /end GROUP
/begin GROUP pmsmfoc_293_FOC_Model_bldc_PMC_PsmMdl1_MCT_PsmParCalc "FOC/bldc/PMC_PsmMdl1/MCT_PsmParCalc"
 /begin REF_CHARACTERISTIC SC_Ld_P SC_Lq_P cLdAdptMon_T cLqAdptMon_T cPsiIsqAdptMot_TT /end REF_CHARACTERISTIC
 /begin REF_MEASUREMENT ISP_iDaFild ISP_iQaFild PMC_Ld PMC_Lq PMC_LqSubLd PMC_PsiExc /end REF_MEASUREMENT
/end GROUP
/begin GROUP pmsmfoc_293_FOC_Model_bldc_PMC_PsmMdl1_PMC_TrqCal "FOC/bldc/PMC_PsmMdl1/PMC_TrqCal"
 /begin SUB_GROUP pmsmfoc_293_FOC_Model_bldc_PMC_PsmMdl1_PMC_TrqCal_Saturation_Dynamic1 /end SUB_GROUP
 /begin REF_CHARACTERISTIC u16_P_MotorPair /end REF_CHARACTERISTIC
/end GROUP
/begin GROUP pmsmfoc_293_FOC_Model_bldc_PMC_PsmMdl1_PMC_TrqCal_Saturation_Dynamic1 "FOC/bldc/PMC_PsmMdl1/PMC_TrqCal/Saturation
Dynamic1" /begin REF_MEASUREMENT PMC_TrqOutEst /end REF_MEASUREMENT /end GROUP
/begin GROUP pmsmfoc_293_FOC_Model_bldc_PT1 "FOC/bldc/PT1" /begin REF_MEASUREMENT PMC_LpfOpt PMC_isqFlt /end REF_MEASUREMENT /end GROUP
/begin GROUP pmsmfoc_293_FOC_Model_bldc_PT2 "FOC/bldc/PT2" /begin REF_MEASUREMENT PMC_LpfOpt PMC_isdFlt /end REF_MEASUREMENT /end GROUP
/begin GROUP pmsmfoc_293_FOC_Model_bldc_PT3 "FOC/bldc/PT3" /begin REF_MEASUREMENT PMC_LpfSpdAct /end REF_MEASUREMENT /end GROUP
/begin GROUP pmsmfoc_293_FOC_Model_bldc_PWMfreq "FOC/bldc/PWMfreq" /begin REF_CHARACTERISTIC PWMFrqSwitch_C g_msgCore0to2_pwmFrqSet /end REF_CHARACTERISTIC /begin REF_MEASUREMENT PMC_pwmfrq /end REF_MEASUREMENT /end GROUP
/begin GROUP pmsmfoc_293_FOC_Model_bldc_Subsystem "FOC/bldc/Subsystem" /begin REF_MEASUREMENT o_o_o_f32_Duty_f32_DutyUon /end REF_MEASUREMENT /end GROUP
/begin GROUP pmsmfoc_293_FOC_Model_bldc_Subsystem1 "FOC/bldc/Subsystem1"
 /begin REF_CHARACTERISTIC g_msgCore0to2_AcrKi g_msgCore0to2_AcrKiStb g_msgCore0to2_AcrKp g_msgCore0to2_AcrKpStb g_msgCore0to2_AcrSwtHiRpm g_msgCore0to2_AcrSwtLoRpm g_msgCore0to2_linearKpEn g_msgCore0to2_maxCur g_msgCore0to2_pwmFrqSet /end REF_CHARACTERISTIC
 /begin REF_MEASUREMENT FOC_AcrKpCalOpt FOC_CurKp PMC_LpfSpdAct PMC_pwmfrq /end REF_MEASUREMENT
/end GROUP
/begin GROUP pmsmfoc_293_FOC_Model_bldc_Subsystem3 "FOC/bldc/Subsystem3" /begin REF_MEASUREMENT PMC_UsdFlt /end REF_MEASUREMENT /end GROUP
/begin GROUP pmsmfoc_293_FOC_Model_bldc_Subsystem4 "FOC/bldc/Subsystem4" /begin REF_MEASUREMENT PMC_UsqFlt /end REF_MEASUREMENT /end GROUP
/begin GROUP pmsmfoc_293_FOC_Model_bldc_abc2dq "FOC/bldc/abc2dq" /begin SUB_GROUP pmsmfoc_293_FOC_Model_bldc_abc2dq_Transform /end SUB_GROUP /end GROUP
/begin GROUP pmsmfoc_293_FOC_Model_bldc_abc2dq_Transform "FOC/bldc/abc2dq/Transform" /begin SUB_GROUP pmsmfoc_293_FOC_Model_bldc_abc2dq_Transform_Subsystem /end SUB_GROUP /end GROUP
/begin GROUP pmsmfoc_293_FOC_Model_bldc_abc2dq_Transform_Subsystem "FOC/bldc/abc2dq/Transform/Subsystem" /begin REF_CHARACTERISTIC g_msgCore0to2_motorseq /end REF_CHARACTERISTIC /end GROUP
/begin GROUP pmsmfoc_CDD_ISP_CDD_ISP "pmsmfoc/CDD&ISP"
 /begin SUB_GROUP pmsmfoc_CDD_ISP_CDD_ISP_CddPhaCur_CddRslvr pmsmfoc_CDD_ISP_CDD_ISP_ISP_ResolverSel /end SUB_GROUP
 /begin REF_MEASUREMENT ISP_iDcFlt ISP_lossTotalIGBT ISP_tmpClnt ISP_tmpMaxIGBT /end REF_MEASUREMENT
/end GROUP
/begin GROUP pmsmfoc_CDD_ISP_CDD_ISP_CddPhaCur_CddRslvr "CDD_ISP/CddPhaCur&CddRslvr"
 /begin SUB_GROUP pmsmfoc_CDD_ISP_CDD_ISP_CddPhaCur_CddRslvr_CddPhaCur_CalnIpha pmsmfoc_CDD_ISP_CDD_ISP_CddPhaCur_CddRslvr_CddRslvr_CalnPosCaln pmsmfoc_CDD_ISP_CDD_ISP_CddPhaCur_CddRslvr_ISP_AnaCalnUdcLnk_and_Flt /end SUB_GROUP
 /begin REF_MEASUREMENT ISP_agRtrElecAtan2 ISP_frqElecCaln ISP_uDcFlt /end REF_MEASUREMENT
/end GROUP
/begin GROUP pmsmfoc_CDD_ISP_CDD_ISP_CddPhaCur_CddRslvr_CddPhaCur_CalnIpha "CDD_ISP/CddPhaCur&CddRslvr/CddPhaCur_CalnIpha"
 /begin SUB_GROUP pmsmfoc_CDD_ISP_CDD_ISP_CddPhaCur_CddRslvr_CddPhaCur_CalnIpha_Saturation_Dynamic pmsmfoc_CDD_ISP_CDD_ISP_CddPhaCur_CddRslvr_CddPhaCur_CalnIpha_Saturation_Dynamic1 pmsmfoc_CDD_ISP_CDD_ISP_CddPhaCur_CddRslvr_CddPhaCur_CalnIpha_Saturation_Dynamic2 /end SUB_GROUP
 /begin REF_CHARACTERISTIC facAdc2iPh_C iPhaMax_C iPhaMin_C /end REF_CHARACTERISTIC
 /begin REF_MEASUREMENT ISP_iPhaU ISP_iPhaV ISP_iPhaW /end REF_MEASUREMENT
/end GROUP
/begin GROUP pmsmfoc_CDD_ISP_CDD_ISP_CddPhaCur_CddRslvr_CddPhaCur_CalnIpha_Saturation_Dynamic "CDD_ISP/CddPhaCur&CddRslvr/CddPhaCur_CalnIpha/Saturation
Dynamic" /begin REF_MEASUREMENT ISP_iPhaU /end REF_MEASUREMENT /end GROUP
/begin GROUP pmsmfoc_CDD_ISP_CDD_ISP_CddPhaCur_CddRslvr_CddPhaCur_CalnIpha_Saturation_Dynamic1 "CDD_ISP/CddPhaCur&CddRslvr/CddPhaCur_CalnIpha/Saturation
Dynamic1" /begin REF_MEASUREMENT ISP_iPhaV /end REF_MEASUREMENT /end GROUP
/begin GROUP pmsmfoc_CDD_ISP_CDD_ISP_CddPhaCur_CddRslvr_CddPhaCur_CalnIpha_Saturation_Dynamic2 "CDD_ISP/CddPhaCur&CddRslvr/CddPhaCur_CalnIpha/Saturation
Dynamic2" /begin REF_MEASUREMENT ISP_iPhaW /end REF_MEASUREMENT /end GROUP
/begin GROUP pmsmfoc_CDD_ISP_CDD_ISP_CddPhaCur_CddRslvr_CddRslvr_CalnPosCaln "CDD_ISP/CddPhaCur&CddRslvr/CddRslvr_CalnPosCaln"
 /begin SUB_GROUP pmsmfoc_CDD_ISP_CDD_ISP_CddPhaCur_CddRslvr_CddRslvr_CalnPosCaln_PT1 /end SUB_GROUP
 /begin REF_CHARACTERISTIC f32_SpeedFltCoef g_msgCore0to2_L1 g_msgCore0to2_L2 rotatedirection_C /end REF_CHARACTERISTIC
 /begin REF_MEASUREMENT ISP_agRtrElecAtan2 omega_hat_K_1 theta_hat_K_1 /end REF_MEASUREMENT
/end GROUP
/begin GROUP pmsmfoc_CDD_ISP_CDD_ISP_CddPhaCur_CddRslvr_CddRslvr_CalnPosCaln_PT1 "CDD_ISP/CddPhaCur&CddRslvr/CddRslvr_CalnPosCaln/PT1" /begin REF_MEASUREMENT ISP_frqElecCaln /end REF_MEASUREMENT /end GROUP
/begin GROUP pmsmfoc_CDD_ISP_CDD_ISP_CddPhaCur_CddRslvr_ISP_AnaCalnUdcLnk_and_Flt "CDD_ISP/CddPhaCur&CddRslvr/ISP_AnaCalnUdcLnk and Flt"
 /begin SUB_GROUP pmsmfoc_CDD_ISP_CDD_ISP_CddPhaCur_CddRslvr_ISP_AnaCalnUdcLnk_and_Flt_PT1 /end SUB_GROUP
 /begin REF_CHARACTERISTIC facAdc2uDclnk_C tauUdcPT1_C uDcMax_C uDcMin_C /end REF_CHARACTERISTIC
/end GROUP
/begin GROUP pmsmfoc_CDD_ISP_CDD_ISP_CddPhaCur_CddRslvr_ISP_AnaCalnUdcLnk_and_Flt_PT1 "CDD_ISP/CddPhaCur&CddRslvr/ISP_AnaCalnUdcLnk and Flt/PT1" /begin REF_MEASUREMENT ISP_uDcFlt /end REF_MEASUREMENT /end GROUP
/begin GROUP pmsmfoc_CDD_ISP_CDD_ISP_ISP_ResolverSel "CDD_ISP/ISP_ResolverSel"
 /begin REF_CHARACTERISTIC IdROL_C SC_pRsv_P SC_p_P agNegTrans_C g_msgCore0to2_N111 g_msgCore0to2_N222 g_msgCore0to2_depth g_msgCore0to2_detlaAngle_single g_msgCore0to2_fbw g_msgCore0to2_wb offsAgRtrElec_C /end REF_CHARACTERISTIC
 /begin REF_MEASUREMENT B ISP_agRoughCal ISP_agRtrElec ISP_agRtrPoleTrans ISP_frqElec ISP_n ISP_n_test_notch ISP_n_test_pp ISP_speedref_final ISP_speedref_final_wn ISP_wElec X111 X222 Y111 Y222 a1 a2 a3 b1 b2 b3 k1 k2 temp1_111 temp2_222 test2 test8 /end REF_MEASUREMENT
/end GROUP
/begin GROUP pmsmfoc_CoreMsgIf "pmsmfoc/CoreMsgIf" /begin REF_MEASUREMENT ISP_n /end REF_MEASUREMENT /end GROUP
/begin GROUP pmsmfoc_PMC_SVM "pmsmfoc/PMC&SVM" /begin SUB_GROUP pmsmfoc_PMC_SVM_PMC /end SUB_GROUP
 /begin REF_CHARACTERISTIC FFW_enable PWMFrqSwitch_C SC_Ld_P SC_Lq_P SC_Psi_P f32_P_AngleCompCur f32_P_AngleCompVol f32_P_Coef f32_P_Modulation g_msgCore0to2_AcrKi g_msgCore0to2_AcrKiStb g_msgCore0to2_AcrKp g_msgCore0to2_AcrKpStb g_msgCore0to2_AcrSwtHiRpm g_msgCore0to2_AcrSwtLoRpm g_msgCore0to2_AfrKp g_msgCore0to2_AfrTi g_msgCore0to2_CalibEn g_msgCore0to2_DecoupleEn g_msgCore0to2_FFW_Gain g_msgCore0to2_MTPA_Gain g_msgCore0to2_arc_dd_fi g_msgCore0to2_clpwitch g_msgCore0to2_dqLpf g_msgCore0to2_dqLpfSpdCoef g_msgCore0to2_linearKpEn g_msgCore0to2_maxCur g_msgCore0to2_maxFwcCurRatio g_msgCore0to2_motorseq g_msgCore0to2_pwmFrqSet g_msgCore0to2_spdswitch u16_P_MotorPair /end REF_CHARACTERISTIC
 /begin REF_MEASUREMENT PMC_IsdDes PMC_IsqDes PMC_TrqOutEst PMC_UsdFlt PMC_UsqFlt usage /end REF_MEASUREMENT
/end GROUP
/begin GROUP pmsmfoc_PMC_SVM_PMC "pmsmfoc/PMC&SVM/PMC" /begin REF_CHARACTERISTIC PWMFrqSwitch_C g_msgCore0to2_pwmFrqSet /end REF_CHARACTERISTIC /begin REF_MEASUREMENT PMC_UsMax PMC_flgReqSafeSt PMC_stGateDrv PMC_tiPerd /end REF_MEASUREMENT /end GROUP
/end MODULE
/end PROJECT
/* (add any file trailer comments here) */
/* EOF pmsmfoc.a2l*/
